/**
 * Generated by C-Next Transpiler from: blink.cnx
 * A safer C for embedded systems
 */

#include "blink.h"

// =============================================================================
// Includes - C-Next passes these through to generated C
// =============================================================================
#include <stdint.h>
#include <stdbool.h>

// blink_systick.cnx - LED Blink for Nucleo-F446RE with SysTick Timer
// Target: Nucleo-F446RE (STM32F446RE - ARM Cortex-M4F @ 180 MHz max)
// Built-in LED (LD2) is on GPIOA, Pin 5
//
// Compile: cnx blink_systick.cnx -o blink_systick.c
// Then use with STM32CubeIDE, PlatformIO, or arm-none-eabi-gcc
//
// This example uses the SysTick hardware timer for accurate delays
// instead of busy-wait loops. SysTick is a 24-bit countdown timer
// built into all ARM Cortex-M processors.
// =============================================================================
// Target Platform (for atomic operations - ADR-049)
// =============================================================================

#include <stdint.h>
#include <stdbool.h>
#include <cmsis_gcc.h>

// ADR-044: Overflow helper functions
#include <limits.h>

static inline uint32_t cnx_clamp_add_u32(uint32_t a, uint64_t b) {
    if (b > (uint64_t)(UINT32_MAX - a)) return UINT32_MAX;
    uint32_t result;
    if (__builtin_add_overflow(a, (uint32_t)b, &result)) return UINT32_MAX;
    return result;
}

// =============================================================================
// SysTick Timer Scope (ARM Cortex-M System Timer)
// =============================================================================
// SysTick is a 24-bit countdown timer present in all Cortex-M processors
// Base address: 0xE000E010 (part of System Control Space)
/* Scope: SysTick */

/* Register: SysTick_Regs @ 0xE000E010 */
#define SysTick_Regs_CTRL (*(volatile SysTick_ControlBits*)(0xE000E010 + 0x00))
#define SysTick_Regs_LOAD (*(volatile uint32_t*)(0xE000E010 + 0x04))
#define SysTick_Regs_VAL (*(volatile uint32_t*)(0xE000E010 + 0x08))
#define SysTick_Regs_CALIB (*(volatile uint32_t const *)(0xE000E010 + 0x0C))


void SysTick_init(void) {
    SysTick_Regs_CTRL = (SysTick_Regs_CTRL & ~(1U << 0)) | (0U << 0);
    SysTick_Regs_LOAD = 15999;
    SysTick_Regs_VAL = 0;
    SysTick_Regs_CTRL = (SysTick_Regs_CTRL & ~(1U << 2)) | (1U << 2);
    SysTick_Regs_CTRL = (SysTick_Regs_CTRL & ~(1U << 1)) | (1U << 1);
    SysTick_Regs_CTRL = (SysTick_Regs_CTRL & ~(1U << 0)) | (1U << 0);
}

// =============================================================================
// RCC (Reset and Clock Control) Scope
// =============================================================================
/* Scope: RCC */

/* Register: RCC_RCC @ 0x40023800 */
#define RCC_RCC_AHB1ENR (*(volatile RCC_AHB1Peripherals*)(0x40023800 + 0x30))


// =============================================================================
// STM32F446 Platform Scope (Simplified for SysTick example)
// =============================================================================
/* Scope: STM32F446 */

/* Register: STM32F446_GPIOA @ 0x40020000 */
#define STM32F446_GPIOA_ModeRegister (*(volatile uint32_t*)(0x40020000 + 0x00))
#define STM32F446_GPIOA_OutputTypeRegister (*(volatile STM32F446_GPIOAPins*)(0x40020000 + 0x04))
#define STM32F446_GPIOA_OutputSpeedRegister (*(volatile uint32_t*)(0x40020000 + 0x08))
#define STM32F446_GPIOA_PullUpDownRegister (*(volatile uint32_t*)(0x40020000 + 0x0C))
#define STM32F446_GPIOA_InputData (*(volatile STM32F446_GPIOAPins const *)(0x40020000 + 0x10))
#define STM32F446_GPIOA_OutputData (*(volatile STM32F446_GPIOAPins*)(0x40020000 + 0x14))
#define STM32F446_GPIOA_BitSetReset (*(volatile STM32F446_GPIOAPins*)(0x40020000 + 0x18))
#define STM32F446_GPIOA_LockRegister (*(volatile STM32F446_GPIOAPins*)(0x40020000 + 0x1C))
#define STM32F446_GPIOA_AlternateFunctionLow (*(volatile uint32_t*)(0x40020000 + 0x20))
#define STM32F446_GPIOA_AlternateFunctionHigh (*(volatile uint32_t*)(0x40020000 + 0x24))


// =============================================================================
// LED Control
// =============================================================================
/* Scope: LED */

void LED_init(void) {
    RCC_RCC_AHB1ENR = (RCC_RCC_AHB1ENR & ~(1U << 0)) | (1U << 0);
    STM32F446_GPIOA_ModeRegister = (STM32F446_GPIOA_ModeRegister & ~(((1U << 2) - 1) << 10)) | (((uint8_t)STM32F446_GPIOMode_OUTPUT & ((1U << 2) - 1)) << 10);
    STM32F446_GPIOA_OutputTypeRegister = (STM32F446_GPIOA_OutputTypeRegister & ~(1U << 5)) | (((bool)STM32F446_GPIOOutputType_PUSH_PULL ? 1U : 0U) << 5);
    STM32F446_GPIOA_OutputSpeedRegister = (STM32F446_GPIOA_OutputSpeedRegister & ~(((1U << 2) - 1) << 10)) | (((uint8_t)STM32F446_GPIOSpeed_MEDIUM & ((1U << 2) - 1)) << 10);
    STM32F446_GPIOA_PullUpDownRegister = (STM32F446_GPIOA_PullUpDownRegister & ~(((1U << 2) - 1) << 10)) | (((uint8_t)STM32F446_GPIOPull_NO_PULL & ((1U << 2) - 1)) << 10);
}

void LED_on(void) {
    STM32F446_GPIOA_BitSetReset = (1U << 5);
}

void LED_off(void) {
    STM32F446_GPIOA_BitSetReset = (1U << 21);
}

void LED_toggle(void) {
    if (((STM32F446_GPIOA_OutputData >> 5) & 1) == true) {
        LED_off();
    } else {
        LED_on();
    }
}

bool LED_isOn(void) {
    return ((STM32F446_GPIOA_OutputData >> 5) & 1);
}

// =============================================================================
// Application Configuration
// =============================================================================
const uint32_t BLINK_DELAY_MS = 2000U;

// Millisecond counter incremented by SysTick ISR
// Must be atomic since it's shared between main and ISR
volatile uint32_t tick_count = 0U;

// =============================================================================
// SysTick Interrupt Service Routine
// =============================================================================
/**
 * SysTick_Handler is called every 1ms by the hardware
 * This function name is defined by ARM Cortex-M vector table
 */
void SysTick_Handler(void) {
    {
        uint32_t __primask = __get_PRIMASK();
        __disable_irq();
        tick_count = cnx_clamp_add_u32(tick_count, 1U);
        __set_PRIMASK(__primask);
    }
}

// =============================================================================
// Main Entry Point
// =============================================================================
void setup(void) {
    SysTick_init();
    LED_init();
}

void loop(void) {
    if (tick_count >= BLINK_DELAY_MS) {
        LED_toggle();
        tick_count = 0U;
    }
}

int main(void) {
    setup();
    /* MISRA C:2012 Rule 14.3: infinite loop is intentional (C-Next `forever`) */
    for (;;) {
        loop();
    }
}
