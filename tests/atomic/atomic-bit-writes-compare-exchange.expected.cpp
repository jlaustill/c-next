/**
 * generated by cnx from: atomic-bit-writes-compare-exchange.test.cnx
 * A safer C for embedded systems
 * Requires: C++11.
 * GNU/Clang extensions: GNU __atomic builtins.
 */

#include "atomic-bit-writes-compare-exchange.test.hpp"


#include <stdint.h>
#include <stdbool.h>

static_assert(sizeof(float) == 4, "Float bit indexing requires 32-bit float");
static_assert(sizeof(double) == 8, "Float bit indexing requires 64-bit double");

// test-adr: 049
// Review of #2155: on a target with neither LDREX/STREX nor an interrupt mask
// (ADR-049, #1789), a bit, a bit range and a bitmap field written to an atomic
// value are a compare-exchange loop, as a compound write is: an unsigned and
// a signed integer, a bitmap, an f32 and an f64 through their bits' unions,
// and a u64. The written values are not literals, and the file has no other
// `bool`, so 2.2 plans <stdbool.h> for the single-bit writes' operand.
volatile uint32_t word = 0;

volatile int32_t sword = 0;

volatile uint64_t dword = 0;

volatile Flags flags = {};

volatile float fl = 0.0f;

volatile double dbl = 0.0;

void set(const uint32_t x) {
    {
        /* ADR-049 / Issue #1789: atomic read-modify-write as a compare-exchange retry loop, for a target with neither LDREX/STREX nor an interrupt mask. The GNU __atomic builtins are a compiler extension (MISRA C:2012 Rule 1.2). The value is evaluated once, before the loop, so a failed exchange does not evaluate it again (Issue #1807). */
        bool __operand = x > 5;
        uint32_t __old;
        uint32_t __new;
        __atomic_load(&word, &__old, __ATOMIC_RELAXED);
        do {
            __new = (__old & ~((uint32_t)1U << 3)) | ((uint32_t)(__operand ? 1U : 0U) << 3);
        } while (!__atomic_compare_exchange(&word, &__old, &__new, 0, __ATOMIC_SEQ_CST, __ATOMIC_RELAXED));
    }
    {
        /* ADR-049 / Issue #1789: atomic read-modify-write as a compare-exchange retry loop, for a target with neither LDREX/STREX nor an interrupt mask. The GNU __atomic builtins are a compiler extension (MISRA C:2012 Rule 1.2). The value is evaluated once, before the loop, so a failed exchange does not evaluate it again (Issue #1807). */
        uint32_t __operand = x;
        uint32_t __old;
        uint32_t __new;
        __atomic_load(&word, &__old, __ATOMIC_RELAXED);
        do {
            __new = (__old & ~((uint32_t)0x7U << 2)) | ((__operand & (uint32_t)0x7U) << 2);
        } while (!__atomic_compare_exchange(&word, &__old, &__new, 0, __ATOMIC_SEQ_CST, __ATOMIC_RELAXED));
    }
    {
        /* ADR-049 / Issue #1789: atomic read-modify-write as a compare-exchange retry loop, for a target with neither LDREX/STREX nor an interrupt mask. The GNU __atomic builtins are a compiler extension (MISRA C:2012 Rule 1.2). The value is evaluated once, before the loop, so a failed exchange does not evaluate it again (Issue #1807). */
        bool __operand = x > 6;
        int32_t __old;
        int32_t __new;
        __atomic_load(&sword, &__old, __ATOMIC_RELAXED);
        do {
            __new = (int32_t)((__old & ~((uint32_t)1U << 4)) | ((uint32_t)(__operand ? 1U : 0U) << 4));
        } while (!__atomic_compare_exchange(&sword, &__old, &__new, 0, __ATOMIC_SEQ_CST, __ATOMIC_RELAXED));
    }
    {
        /* ADR-049 / Issue #1789: atomic read-modify-write as a compare-exchange retry loop, for a target with neither LDREX/STREX nor an interrupt mask. The GNU __atomic builtins are a compiler extension (MISRA C:2012 Rule 1.2). The value is evaluated once, before the loop, so a failed exchange does not evaluate it again (Issue #1807). */
        uint32_t __operand = x;
        int32_t __old;
        int32_t __new;
        __atomic_load(&sword, &__old, __ATOMIC_RELAXED);
        do {
            __new = (int32_t)((__old & ~((uint32_t)0xFU << 8)) | ((__operand & (uint32_t)0xFU) << 8));
        } while (!__atomic_compare_exchange(&sword, &__old, &__new, 0, __ATOMIC_SEQ_CST, __ATOMIC_RELAXED));
    }
    {
        /* ADR-049 / Issue #1789: atomic read-modify-write as a compare-exchange retry loop, for a target with neither LDREX/STREX nor an interrupt mask. The GNU __atomic builtins are a compiler extension (MISRA C:2012 Rule 1.2). The value is evaluated once, before the loop, so a failed exchange does not evaluate it again (Issue #1807). */
        bool __operand = x > 7;
        uint64_t __old;
        uint64_t __new;
        __atomic_load(&dword, &__old, __ATOMIC_RELAXED);
        do {
            __new = (__old & ~((uint64_t)1U << 40)) | ((uint64_t)(__operand ? 1U : 0U) << 40);
        } while (!__atomic_compare_exchange(&dword, &__old, &__new, 0, __ATOMIC_SEQ_CST, __ATOMIC_RELAXED));
    }
    {
        /* ADR-049 / Issue #1789: atomic read-modify-write as a compare-exchange retry loop, for a target with neither LDREX/STREX nor an interrupt mask. The GNU __atomic builtins are a compiler extension (MISRA C:2012 Rule 1.2). The value is evaluated once, before the loop, so a failed exchange does not evaluate it again (Issue #1807). */
        uint8_t __operand = 3U;
        uint8_t __old;
        uint8_t __new;
        __atomic_load(&flags, &__old, __ATOMIC_RELAXED);
        do {
            __new = (uint8_t)((__old & ~(0x7U << 2)) | ((__operand & 0x7U) << 2));
        } while (!__atomic_compare_exchange(&flags, &__old, &__new, 0, __ATOMIC_SEQ_CST, __ATOMIC_RELAXED));
    }
    {
        /* ADR-049 / Issue #1789: atomic read-modify-write as a compare-exchange retry loop, for a target with neither LDREX/STREX nor an interrupt mask. The GNU __atomic builtins are a compiler extension (MISRA C:2012 Rule 1.2). The value is evaluated once, before the loop, so a failed exchange does not evaluate it again (Issue #1807). */
        bool __operand = x > 8;
        uint8_t __old;
        uint8_t __new;
        __atomic_load(&flags, &__old, __ATOMIC_RELAXED);
        do {
            __new = (uint8_t)((__old & ~(1U << 0)) | ((__operand ? 1U : 0U) << 0));
        } while (!__atomic_compare_exchange(&flags, &__old, &__new, 0, __ATOMIC_SEQ_CST, __ATOMIC_RELAXED));
    }
    {
        /* ADR-049 / Issue #1789: atomic read-modify-write as a compare-exchange retry loop, for a target with neither LDREX/STREX nor an interrupt mask. The GNU __atomic builtins are a compiler extension (MISRA C:2012 Rule 1.2). The value is evaluated once, before the loop, so a failed exchange does not evaluate it again (Issue #1807). */
        bool __operand = x > 9;
        /* MISRA C:2012 Rule 21.15: float bits accessed through a union (memcpy would pass incompatible pointer types: float* vs uint32_t*). */
        union { float f; uint32_t u; } __old;
        /* MISRA C:2012 Rule 21.15: float bits accessed through a union (memcpy would pass incompatible pointer types: float* vs uint32_t*). */
        union { float f; uint32_t u; } __new;
        __atomic_load(&fl, &__old.f, __ATOMIC_RELAXED);
        do {
            __new.u = (__old.u & ~((uint32_t)1U << 31)) | ((uint32_t)(__operand ? 1U : 0U) << 31);
        } while (!__atomic_compare_exchange(&fl, &__old.f, &__new.f, 0, __ATOMIC_SEQ_CST, __ATOMIC_RELAXED));
    }
    {
        /* ADR-049 / Issue #1789: atomic read-modify-write as a compare-exchange retry loop, for a target with neither LDREX/STREX nor an interrupt mask. The GNU __atomic builtins are a compiler extension (MISRA C:2012 Rule 1.2). The value is evaluated once, before the loop, so a failed exchange does not evaluate it again (Issue #1807). */
        uint32_t __operand = x;
        /* MISRA C:2012 Rule 21.15: float bits accessed through a union (memcpy would pass incompatible pointer types: float* vs uint32_t*). */
        union { float f; uint32_t u; } __old;
        /* MISRA C:2012 Rule 21.15: float bits accessed through a union (memcpy would pass incompatible pointer types: float* vs uint32_t*). */
        union { float f; uint32_t u; } __new;
        __atomic_load(&fl, &__old.f, __ATOMIC_RELAXED);
        do {
            __new.u = (__old.u & ~((uint32_t)0xFU << 0)) | ((__operand & (uint32_t)0xFU) << 0);
        } while (!__atomic_compare_exchange(&fl, &__old.f, &__new.f, 0, __ATOMIC_SEQ_CST, __ATOMIC_RELAXED));
    }
    {
        /* ADR-049 / Issue #1789: atomic read-modify-write as a compare-exchange retry loop, for a target with neither LDREX/STREX nor an interrupt mask. The GNU __atomic builtins are a compiler extension (MISRA C:2012 Rule 1.2). The value is evaluated once, before the loop, so a failed exchange does not evaluate it again (Issue #1807). */
        bool __operand = x > 10;
        /* MISRA C:2012 Rule 21.15: float bits accessed through a union (memcpy would pass incompatible pointer types: double* vs uint64_t*). */
        union { double f; uint64_t u; } __old;
        /* MISRA C:2012 Rule 21.15: float bits accessed through a union (memcpy would pass incompatible pointer types: double* vs uint64_t*). */
        union { double f; uint64_t u; } __new;
        __atomic_load(&dbl, &__old.f, __ATOMIC_RELAXED);
        do {
            __new.u = (__old.u & ~((uint64_t)1U << 63)) | ((uint64_t)(__operand ? 1U : 0U) << 63);
        } while (!__atomic_compare_exchange(&dbl, &__old.f, &__new.f, 0, __ATOMIC_SEQ_CST, __ATOMIC_RELAXED));
    }
    {
        /* ADR-049 / Issue #1789: atomic read-modify-write as a compare-exchange retry loop, for a target with neither LDREX/STREX nor an interrupt mask. The GNU __atomic builtins are a compiler extension (MISRA C:2012 Rule 1.2). The value is evaluated once, before the loop, so a failed exchange does not evaluate it again (Issue #1807). */
        uint64_t __operand = x;
        /* MISRA C:2012 Rule 21.15: float bits accessed through a union (memcpy would pass incompatible pointer types: double* vs uint64_t*). */
        union { double f; uint64_t u; } __old;
        /* MISRA C:2012 Rule 21.15: float bits accessed through a union (memcpy would pass incompatible pointer types: double* vs uint64_t*). */
        union { double f; uint64_t u; } __new;
        __atomic_load(&dbl, &__old.f, __ATOMIC_RELAXED);
        do {
            __new.u = (__old.u & ~((uint64_t)0xFFU << 0)) | ((__operand & (uint64_t)0xFFU) << 0);
        } while (!__atomic_compare_exchange(&dbl, &__old.f, &__new.f, 0, __ATOMIC_SEQ_CST, __ATOMIC_RELAXED));
    }
}

int main(void) {
    set(6U);
}
