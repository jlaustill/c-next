/**
 * Generated by C-Next Transpiler from: small-unmodified.test.cnx
 * A safer C for embedded systems
 * Requires: C99.
 * critical section requires one of: ARMv7-M core + Arduino core, ARMv7-M core, avr-libc, CMSIS (by target).
 */

#include "small-unmodified.test.h"

#include <stdint.h>
#include <stdbool.h>

// ADR-050: Platform-portable IRQ wrappers for critical sections
#if defined(__arm__) || defined(__ARM_ARCH)
// ARM platforms (including ARM Arduino like Teensy 4.x, Due, Zero)
// Provide inline assembly PRIMASK access to avoid CMSIS header dependencies
__attribute__((always_inline)) static inline uint32_t __cnx_get_PRIMASK(void) {
    uint32_t result;
    __asm volatile ("MRS %0, primask" : "=r" (result));
    return result;
}
__attribute__((always_inline)) static inline void __cnx_set_PRIMASK(uint32_t mask) {
    __asm volatile ("MSR primask, %0" :: "r" (mask) : "memory");
}
#if defined(ARDUINO)
static inline void __cnx_disable_irq(void) { noInterrupts(); }
#else
__attribute__((always_inline)) static inline void __cnx_disable_irq(void) {
    __asm volatile ("cpsid i" ::: "memory");
}
#endif
#elif defined(__AVR__)
// AVR Arduino: use SREG for interrupt state
// Note: Uses PRIMASK naming for API consistency across platforms (AVR has no PRIMASK)
// Returns uint8_t which is implicitly widened to uint32_t at call sites - this is intentional
static inline uint8_t __cnx_get_PRIMASK(void) { return SREG; }
static inline void __cnx_set_PRIMASK(uint8_t mask) { SREG = mask; }
static inline void __cnx_disable_irq(void) { cli(); }
#else
// Fallback: assume CMSIS is available
static inline void __cnx_disable_irq(void) { __disable_irq(); }
static inline uint32_t __cnx_get_PRIMASK(void) { return __get_PRIMASK(); }
static inline void __cnx_set_PRIMASK(uint32_t mask) { __set_PRIMASK(mask); }
#endif

// ADR-044: Overflow helper functions
#include <limits.h>

/* ADR-044 / Issue #94: the second parameter is the WIDER type, not the value type.
   Narrowing it first would let an out-of-range operand truncate INTO range and defeat
   the check: cnx_clamp_add_u8(0, 256) must saturate to 255, but (uint8_t)256 is 0, so a
   uint8_t parameter would return 0 -- the opposite of saturation. */

static inline uint32_t cnx_clamp_add_u32(uint32_t a, uint64_t b) {
    if (b > (uint64_t)(UINT32_MAX - a)) return UINT32_MAX;
    return (uint32_t)(a + (uint32_t)b);
}

static inline uint16_t cnx_clamp_mul_u16(uint16_t a, uint32_t b) {
    if (b != 0 && a > UINT16_MAX / b) return UINT16_MAX;
    return (uint16_t)(a * (uint16_t)b);
}

static inline uint32_t cnx_clamp_mul_u32(uint32_t a, uint64_t b) {
    if (b != 0 && a > UINT32_MAX / b) return UINT32_MAX;
    return (uint32_t)(a * (uint32_t)b);
}

// test-c-only
// test-execution
// Issue #269: Pass-by-value for small unmodified parameters
// Tests that unmodified small primitive types pass by value,
// while modified parameters still pass by pointer.
// --- Unmodified parameters: should pass by value ---
uint8_t getLowByte(uint16_t value) {
    return (uint8_t)((value) & 0xFFU);
}

uint8_t getHighByte(uint16_t value) {
    return (uint8_t)((value >> 8U) & 0xFFU);
}

uint32_t addTwo(uint32_t a, uint32_t b) {
    return cnx_clamp_add_u32(a, b);
}

bool invert(bool flag) {
    return !flag;
}

// --- Modified parameters: should still pass by pointer ---
void increment(uint32_t* x) {
    (*x) = cnx_clamp_add_u32((*x), 1U);
}

void doubleValue(uint16_t* val) {
    (*val) = cnx_clamp_mul_u16((*val), 2U);
}

// --- Transitively modified: passed to function that modifies ---
// These should pass by pointer because increment() modifies its param
void incrementWrapper(uint32_t* x) {
    increment(x);
}

// --- Mixed: some params modified, some not ---
uint32_t addAndIncrement(uint32_t* a, uint32_t b) {
    (*a) = cnx_clamp_add_u32((*a), 1U);
    return cnx_clamp_add_u32((*a), b);
}

// --- Modification in switch statement (Issue #269 bug fix) ---
// Parameters modified inside switch cases must still pass by pointer
void modifyInSwitch(uint32_t* x, uint32_t mode) {
    switch (mode) {
        case 1: {
            (*x) = cnx_clamp_add_u32((*x), 10U);
            break;
        }
        case 2: {
            (*x) = cnx_clamp_add_u32((*x), 20U);
            break;
        }
        default: {
            (*x) = cnx_clamp_add_u32((*x), 1U);
            break;
        }
    }
}

// --- Modification in critical section (ADR-050) ---
void modifyInCritical(uint32_t* x) {
    {
        uint32_t __primask = __cnx_get_PRIMASK();
        __cnx_disable_irq();
        (*x) = cnx_clamp_mul_u32((*x), 2U);
        __cnx_set_PRIMASK(__primask);
    }
}

// --- Main test ---
int main(void) {
    uint16_t testVal = 0x1234U;
    uint8_t low = getLowByte(testVal);
    if (low != 0x34) return 1U;
    uint8_t high = getHighByte(testVal);
    if (high != 0x12) return 2U;
    uint32_t sum = addTwo(100U, 200U);
    if (sum != 300) return 3U;
    bool result = invert(true);
    if (result != false) return 4U;
    result = invert(false);
    if (result != true) return 5U;
    uint32_t counter = 10U;
    increment(&counter);
    if (counter != 11) return 6U;
    uint16_t doubled = 50U;
    doubleValue(&doubled);
    if (doubled != 100) return 7U;
    uint32_t wrapped = 20U;
    incrementWrapper(&wrapped);
    if (wrapped != 21) return 8U;
    uint32_t mixedA = 5U;
    uint32_t mixedB = 10U;
    uint32_t mixedResult = addAndIncrement(&mixedA, mixedB);
    if (mixedResult != 16) return 9U;
    if (mixedA != 6) return 10U;
    uint32_t switchVal = 100U;
    modifyInSwitch(&switchVal, 1U);
    if (switchVal != 110) return 11U;
    switchVal = 100U;
    modifyInSwitch(&switchVal, 2U);
    if (switchVal != 120) return 12U;
    switchVal = 100U;
    modifyInSwitch(&switchVal, 99U);
    if (switchVal != 101) return 13U;
    uint32_t criticalVal = 50U;
    modifyInCritical(&criticalVal);
    if (criticalVal != 100) return 14U;
    return 0U;
}
