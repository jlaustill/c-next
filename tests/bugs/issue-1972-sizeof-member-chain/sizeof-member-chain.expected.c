/**
 * Generated by C-Next Transpiler from: sizeof-member-chain.test.cnx
 * A safer C for embedded systems
 */

#include "sizeof-member-chain.test.h"

// test-execution
// Issue #1972: a dotted member access is measured the way the same expression
// reads everywhere else. `sizeof`'s resolver once rebuilt it from its first
// two names (`shared.inner` for `shared.inner.x`, `w.v` for a pointer local,
// `S__cfg__b`, `GPIO.DR`); since #1975 the size is ADR-058's `.type_byte_length`,
// read from the same chain as the value. Each is checked against the width
// of the type the ordinary expression reads.
#include "widget.h"

#include <stdint.h>

/* Scope: S */
Pair S__cfg = {0};

Outer shared = {0};

int main(void) {
    uint32_t nested = 1;
    if (nested != 1) {
        return 1U;
    }
    uint8_t nestedValue = shared.inner.x;
    if (nestedValue != 0) {
        return 2U;
    }
    widget_t* w = widget_get();
    uint32_t pointed = 4;
    if (pointed != 4) {
        return 3U;
    }
    uint32_t pointedValue = w->v;
    if (pointedValue != 5) {
        return 4U;
    }
    uint32_t scoped = 4;
    if (scoped != 4) {
        return 5U;
    }
    uint32_t scopedValue = S__cfg.b;
    if (scopedValue != 0) {
        return 6U;
    }
    uint32_t registerSize = 4;
    if (registerSize != 4) {
        return 7U;
    }
    return 0U;
}
