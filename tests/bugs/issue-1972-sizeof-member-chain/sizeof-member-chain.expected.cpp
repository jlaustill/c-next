/**
 * generated by cnx from: sizeof-member-chain.test.cnx
 * A safer C for embedded systems
 */

#include "sizeof-member-chain.test.hpp"

// test-execution
// Issue #1972: a dotted member access is measured the way the same expression
// reads everywhere else. `sizeof`'s resolver once rebuilt it from its first
// two names (`shared.inner` for `shared.inner.x`, `w.v` for a pointer local,
// `S__cfg__b`, `GPIO.DR`); since #1975 the size is ADR-058's `.type_byte_length`,
// read from the same chain as the value. Each is checked against the width
// of the type the ordinary expression reads.
#include "widget.h"

#include <stdint.h>

/* Scope: S */
const Pair S__cfg = {};

extern const Outer shared = {};

int main(void) {
    const uint32_t nested = 1;
    if (nested != 1) {
        return 1U;
    }
    const uint8_t nestedValue = shared.inner.x;
    if (nestedValue != 0) {
        return 2U;
    }
    const widget_t* w = widget_get();
    const uint32_t pointed = 4;
    if (pointed != 4) {
        return 3U;
    }
    const uint32_t pointedValue = w->v;
    if (pointedValue != 5) {
        return 4U;
    }
    const uint32_t scoped = 4;
    if (scoped != 4) {
        return 5U;
    }
    const uint32_t scopedValue = S__cfg.b;
    if (scopedValue != 0) {
        return 6U;
    }
    const uint32_t registerSize = 4;
    if (registerSize != 4) {
        return 7U;
    }
    return 0U;
}
