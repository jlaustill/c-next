/**
 * Generated by C-Next Transpiler from: isr-in-struct.test.cnx
 * A safer C for embedded systems
 */

#include <stdint.h>

/* ADR-040: ISR function pointer type */
typedef void (*ISR)(void);

/* ADR-044: the clamp/wrap helpers below use __builtin_add_overflow,
   __builtin_sub_overflow and __builtin_mul_overflow. These are GCC 5+ / Clang 3.4+
   extensions, not standard C99, and are chosen because they lower to a single
   add-and-branch-on-carry on Cortex-M. Fail here rather than at the first use */
#ifdef __cppcheck__
/* cppcheck bug: nested #if/#elif inside #ifndef is not fully skipped,
   so we use a positive check (empty body) instead. */
#else
#if defined(__clang__)
#if (__clang_major__ < 3) || ((__clang_major__ == 3) && (__clang_minor__ < 4))
#error "C-Next overflow helpers require Clang 3.4 or later (__builtin_add_overflow)."
#endif
#elif defined(__GNUC__)
#if __GNUC__ < 5
#error "C-Next overflow helpers require GCC 5 or later (__builtin_add_overflow)."
#endif
#else
#error "C-Next overflow helpers require GCC 5+ or Clang 3.4+ (__builtin_add_overflow)."
#endif
#endif /* __cppcheck__ */

// ADR-044: Overflow helper functions
#include <limits.h>

static inline uint32_t cnx_clamp_add_u32(uint32_t a, uint64_t b) {
    if (b > (uint64_t)(UINT32_MAX - a)) return UINT32_MAX;
    uint32_t result;
    if (__builtin_add_overflow(a, (uint32_t)b, &result)) return UINT32_MAX;
    return result;
}

// test-execution
// ADR-040: ISR as struct field
// Tests: storing ISR in struct, retrieving and invoking
// Global to track which handler was called
uint32_t structCallCount = 0U;

uint32_t structLastHandler = 0U;

// Handler functions
void structHandler1(void) {
    structCallCount = cnx_clamp_add_u32(structCallCount, 1U);
    structLastHandler = 1U;
}

void structHandler2(void) {
    structCallCount = cnx_clamp_add_u32(structCallCount, 1U);
    structLastHandler = 2U;
}

void structHandler3(void) {
    structCallCount = cnx_clamp_add_u32(structCallCount, 1U);
    structLastHandler = 3U;
}

// Struct with ISR fields
typedef struct IsrHolder {
    ISR primary;
    ISR secondary;
} IsrHolder;

// Initialize struct with ISR values
void initStructHolder(IsrHolder* hld, ISR prim, ISR sec) {
    hld->primary = (*prim);
    hld->secondary = (*sec);
}

// Invoke ISR from struct field
void invokeStructHolder(const IsrHolder* hld) {
    hld->primary();
    hld->secondary();
}

int main(void) {
    IsrHolder holder = {0};
    holder.primary = structHandler1;
    holder.secondary = structHandler1;
    structCallCount = 0U;
    structLastHandler = 0U;
    holder.primary = structHandler1;
    holder.primary();
    if (structCallCount != 1) return 1;
    if (structLastHandler != 1) return 2;
    structCallCount = 0U;
    structLastHandler = 0U;
    holder.secondary = structHandler2;
    holder.secondary();
    if (structCallCount != 1) return 3;
    if (structLastHandler != 2) return 4;
    structCallCount = 0U;
    structLastHandler = 0U;
    initStructHolder(&holder, &structHandler1, &structHandler3);
    invokeStructHolder(&holder);
    if (structCallCount != 2) return 5;
    if (structLastHandler != 3) return 6;
    structCallCount = 0U;
    holder.primary = structHandler2;
    holder.secondary = structHandler1;
    invokeStructHolder(&holder);
    if (structCallCount != 2) return 7;
    if (structLastHandler != 1) return 8;
    structCallCount = 0U;
    structLastHandler = 0U;
    holder.primary = structHandler3;
    holder.primary();
    if (structCallCount != 1) return 9;
    if (structLastHandler != 3) return 10;
    return 0;
}
