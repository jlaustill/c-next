/**
 * Generated by C-Next Transpiler from: blink.cnx
 * A safer C for embedded systems
 * Requires: C99.
 * atomic read-modify-write requires CMSIS.
 */

#include "blink.h"

// =============================================================================
// Includes - C-Next passes these through to generated C
// =============================================================================
#include <stdint.h>
#include <stdbool.h>

// blink_systick.cnx - LED Blink for Nucleo-F446RE with SysTick Timer
// Target: Nucleo-F446RE (STM32F446RE - ARM Cortex-M4F @ 180 MHz max)
// Built-in LED (LD2) is on GPIOA, Pin 5
//
// Compile: cnx blink_systick.cnx -o blink_systick.c
// Then use with STM32CubeIDE, PlatformIO, or arm-none-eabi-gcc
//
// This example uses the SysTick hardware timer for accurate delays
// instead of busy-wait loops. SysTick is a 24-bit countdown timer
// built into all ARM Cortex-M processors.
// =============================================================================
// Target Platform (for atomic operations - ADR-049)
// =============================================================================

#include <cmsis_gcc.h>

// ADR-044: Overflow helper functions
#include <limits.h>

/* ADR-044 / Issue #94: the second parameter is the WIDER type, not the value type.
   Narrowing it first would let an out-of-range operand truncate INTO range and defeat
   the check: cnx_clamp_add_u8(0, 256) must saturate to 255, but (uint8_t)256 is 0, so a
   uint8_t parameter would return 0 -- the opposite of saturation. */

static inline uint32_t cnx_clamp_add_u32(uint32_t a, uint64_t b) {
    if (b > (uint64_t)(UINT32_MAX - a)) return UINT32_MAX;
    return (uint32_t)(a + (uint32_t)b);
}

// =============================================================================
// SysTick Timer Scope (ARM Cortex-M System Timer)
// =============================================================================
// SysTick is a 24-bit countdown timer present in all Cortex-M processors
// Base address: 0xE000E010 (part of System Control Space)
/* Scope: SysTick */

/* Bitmap: SysTick__ControlBits
 *   ENABLE: bit 0
 *   TICKINT: bit 1
 *   CLKSOURCE: bit 2
 *   Reserved_3: bit 3
 *   Reserved_4: bit 4
 *   Reserved_5: bit 5
 *   Reserved_6: bit 6
 *   Reserved_7: bit 7
 *   Reserved_8: bit 8
 *   Reserved_9: bit 9
 *   Reserved_10: bit 10
 *   Reserved_11: bit 11
 *   Reserved_12: bit 12
 *   Reserved_13: bit 13
 *   Reserved_14: bit 14
 *   Reserved_15: bit 15
 *   COUNTFLAG: bit 16
 *   Reserved_17: bit 17
 *   Reserved_18: bit 18
 *   Reserved_19: bit 19
 *   Reserved_20: bit 20
 *   Reserved_21: bit 21
 *   Reserved_22: bit 22
 *   Reserved_23: bit 23
 *   Reserved_24: bit 24
 *   Reserved_25: bit 25
 *   Reserved_26: bit 26
 *   Reserved_27: bit 27
 *   Reserved_28: bit 28
 *   Reserved_29: bit 29
 *   Reserved_30: bit 30
 *   Reserved_31: bit 31
 */
typedef uint32_t SysTick__ControlBits;

/* Register: SysTick__Regs @ 0xE000E010 */
#define SysTick__Regs__CTRL (*(volatile SysTick__ControlBits*)(0xE000E010 + 0x00))
#define SysTick__Regs__LOAD (*(volatile uint32_t*)(0xE000E010 + 0x04))
#define SysTick__Regs__VAL (*(volatile uint32_t*)(0xE000E010 + 0x08))
#define SysTick__Regs__CALIB (*(volatile uint32_t const *)(0xE000E010 + 0x0C))


void SysTick__init(void) {
    SysTick__Regs__CTRL = (SysTick__Regs__CTRL & ~(1U << 0)) | (0U << 0);
    SysTick__Regs__LOAD = 15999;
    SysTick__Regs__VAL = 0;
    SysTick__Regs__CTRL = (SysTick__Regs__CTRL & ~(1U << 2)) | (1U << 2);
    SysTick__Regs__CTRL = (SysTick__Regs__CTRL & ~(1U << 1)) | (1U << 1);
    SysTick__Regs__CTRL = (SysTick__Regs__CTRL & ~(1U << 0)) | (1U << 0);
}

// =============================================================================
// RCC (Reset and Clock Control) Scope
// =============================================================================
/* Scope: RCC */



// =============================================================================
// STM32F446 Platform Scope (Simplified for SysTick example)
// =============================================================================
/* Scope: STM32F446 */



// =============================================================================
// LED Control
// =============================================================================
/* Scope: LED */

void LED__init(void) {
    RCC__RCC__AHB1ENR = (RCC__RCC__AHB1ENR & ~(1U << 0)) | (1U << 0);
    STM32F446__GPIOA__ModeRegister = (STM32F446__GPIOA__ModeRegister & ~(((1U << 2) - 1) << 10)) | (((uint8_t)STM32F446__GPIOMode__OUTPUT & ((1U << 2) - 1)) << 10);
    STM32F446__GPIOA__OutputTypeRegister = (STM32F446__GPIOA__OutputTypeRegister & ~(1U << 5)) | (((bool)STM32F446__GPIOOutputType__PUSH_PULL ? 1U : 0U) << 5);
    STM32F446__GPIOA__OutputSpeedRegister = (STM32F446__GPIOA__OutputSpeedRegister & ~(((1U << 2) - 1) << 10)) | (((uint8_t)STM32F446__GPIOSpeed__MEDIUM & ((1U << 2) - 1)) << 10);
    STM32F446__GPIOA__PullUpDownRegister = (STM32F446__GPIOA__PullUpDownRegister & ~(((1U << 2) - 1) << 10)) | (((uint8_t)STM32F446__GPIOPull__NO_PULL & ((1U << 2) - 1)) << 10);
}

void LED__on(void) {
    STM32F446__GPIOA__BitSetReset = (1U << 5);
}

void LED__off(void) {
    STM32F446__GPIOA__BitSetReset = (1U << 21);
}

void LED__toggle(void) {
    if (((STM32F446__GPIOA__OutputData >> 5) & 1) == true) {
        LED__off();
    } else {
        LED__on();
    }
}

bool LED__isOn(void) {
    return ((STM32F446__GPIOA__OutputData >> 5) & 1);
}

// =============================================================================
// Application Configuration
// =============================================================================
const uint32_t BLINK_DELAY_MS = 2000U;

// Millisecond counter incremented by SysTick ISR
// Must be atomic since it's shared between main and ISR
volatile uint32_t tick_count = 0U;

// =============================================================================
// SysTick Interrupt Service Routine
// =============================================================================
/**
 * SysTick_Handler is called every 1ms by the hardware
 * This function name is defined by ARM Cortex-M vector table
 */
void SysTick_Handler(void) {
    {
        uint32_t __primask = __get_PRIMASK();
        __disable_irq();
        tick_count = cnx_clamp_add_u32(tick_count, 1U);
        __set_PRIMASK(__primask);
    }
}

// =============================================================================
// Main Entry Point
// =============================================================================
void setup(void) {
    SysTick__init();
    LED__init();
}

void loop(void) {
    if (tick_count >= BLINK_DELAY_MS) {
        LED__toggle();
        tick_count = 0U;
    }
}

int main(void) {
    setup();
    /* MISRA C:2012 Rule 14.3: infinite loop written as `for (;;)` for C-Next `forever` (`while (1)` has a controlling expression with an invariant value, which the rule forbids). */
    for (;;) {
        loop();
    }
}
