/**
 * Generated by C-Next Transpiler
 * A safer C for embedded systems
 */

// test-coverage: 20-atomic-in-critical
// Tests: atomic operations inside critical sections
// Note: Compilation test only - ARM-specific code

#include <stdint.h>
#include <cmsis_gcc.h>

// ADR-050: Platform-portable IRQ wrappers for critical sections
#if defined(__arm__) || defined(__ARM_ARCH)
// ARM platforms (including ARM Arduino like Teensy 4.x, Due, Zero)
// Provide inline assembly PRIMASK access to avoid CMSIS header dependencies
__attribute__((always_inline)) static inline uint32_t __cnx_get_PRIMASK(void) {
    uint32_t result;
    __asm volatile ("MRS %0, primask" : "=r" (result));
    return result;
}
__attribute__((always_inline)) static inline void __cnx_set_PRIMASK(uint32_t mask) {
    __asm volatile ("MSR primask, %0" :: "r" (mask) : "memory");
}
#if defined(ARDUINO)
static inline void __cnx_disable_irq(void) { noInterrupts(); }
#else
__attribute__((always_inline)) static inline void __cnx_disable_irq(void) {
    __asm volatile ("cpsid i" ::: "memory");
}
#endif
#elif defined(__AVR__)
// AVR Arduino: use SREG for interrupt state
// Note: Uses PRIMASK naming for API consistency across platforms (AVR has no PRIMASK)
// Returns uint8_t which is implicitly widened to uint32_t at call sites - this is intentional
static inline uint8_t __cnx_get_PRIMASK(void) { return SREG; }
static inline void __cnx_set_PRIMASK(uint8_t mask) { SREG = mask; }
static inline void __cnx_disable_irq(void) { cli(); }
#else
// Fallback: assume CMSIS is available
static inline void __cnx_disable_irq(void) { __disable_irq(); }
static inline uint32_t __cnx_get_PRIMASK(void) { return __get_PRIMASK(); }
static inline void __cnx_set_PRIMASK(uint32_t mask) { __set_PRIMASK(mask); }
#endif

// ADR-044: Overflow helper functions
#include <limits.h>

static inline uint32_t cnx_clamp_add_u32(uint32_t a, uint64_t b) {
    if (b > (uint64_t)(UINT32_MAX - a)) return UINT32_MAX;
    uint32_t result;
    if (__builtin_add_overflow(a, (uint32_t)b, &result)) return UINT32_MAX;
    return result;
}

volatile uint32_t sharedCounter = 0U;

volatile uint16_t sequence = 0U;

uint8_t buffer[64] = {0};

uint32_t writeIdx = 0U;

// Atomic operation within critical section
void criticalUpdate(void) {
    {
        uint32_t __primask = __cnx_get_PRIMASK();
        __cnx_disable_irq();
        do {
            uint32_t __old = __LDREXW(&sharedCounter);
            uint32_t __new = cnx_clamp_add_u32(__old, 1U);
            if (__STREXW(__new, &sharedCounter) == 0) break;
        } while (1);
        do {
            uint16_t __old = __LDREXH(&sequence);
            uint16_t __new = __old + 1U;
            if (__STREXH(__new, &sequence) == 0) break;
        } while (1);
        __cnx_set_PRIMASK(__primask);
    }
}

// Mixed atomic and non-atomic in critical
void enqueueWithCount(uint8_t data) {
    {
        uint32_t __primask = __cnx_get_PRIMASK();
        __cnx_disable_irq();
        buffer[writeIdx] = data;
        writeIdx = cnx_clamp_add_u32(writeIdx, 1U);
        do {
            uint32_t __old = __LDREXW(&sharedCounter);
            uint32_t __new = cnx_clamp_add_u32(__old, 1U);
            if (__STREXW(__new, &sharedCounter) == 0) break;
        } while (1);
        __cnx_set_PRIMASK(__primask);
    }
}

// Multiple atomic operations in critical
void batchUpdate(uint32_t delta) {
    {
        uint32_t __primask = __cnx_get_PRIMASK();
        __cnx_disable_irq();
        do {
            uint32_t __old = __LDREXW(&sharedCounter);
            uint32_t __new = cnx_clamp_add_u32(__old, delta);
            if (__STREXW(__new, &sharedCounter) == 0) break;
        } while (1);
        do {
            uint16_t __old = __LDREXH(&sequence);
            uint16_t __new = __old + 1U;
            if (__STREXH(__new, &sequence) == 0) break;
        } while (1);
        __cnx_set_PRIMASK(__primask);
    }
}

// Read and write atomic in critical
void conditionalIncrement(void) {
    {
        uint32_t __primask = __cnx_get_PRIMASK();
        __cnx_disable_irq();
        if (sharedCounter < 1000) {
            do {
                uint32_t __old = __LDREXW(&sharedCounter);
                uint32_t __new = cnx_clamp_add_u32(__old, 1U);
                if (__STREXW(__new, &sharedCounter) == 0) break;
            } while (1);
        }
        __cnx_set_PRIMASK(__primask);
    }
}

int main(void) {
    criticalUpdate();
    enqueueWithCount(0xAB);
    batchUpdate(10);
    conditionalIncrement();
}
