/**
 * Generated by C-Next Transpiler from: atomic-host.test.cnx
 * A safer C for embedded systems
 * Requires: C99.
 * GNU/Clang extensions: GNU __atomic builtins.
 */

#include "atomic-host.test.h"

// test-execution
// #1789 / #1147: an atomic read-modify-write on the build machine, which has
// no LDREX/STREX and cannot mask interrupts. It was lowered to the IRQ
// wrappers' CMSIS fallback, which no host header declares, so the C failed to
// compile. Each compound form, plain and saturating, must keep its value.

#include <stdint.h>

// ADR-044: Overflow helper functions
#include <limits.h>

/* ADR-044 / Issue #94: the second parameter is the WIDER type, not the value type.
   Narrowing it first would let an out-of-range operand truncate INTO range and defeat
   the check: cnx_clamp_add_u8(0, 256) must saturate to 255, but (uint8_t)256 is 0, so a
   uint8_t parameter would return 0 -- the opposite of saturation. */

static inline uint32_t cnx_clamp_add_u32(uint32_t a, uint64_t b) {
    if (b > (uint64_t)(UINT32_MAX - a)) return UINT32_MAX;
    return (uint32_t)(a + (uint32_t)b);
}

static inline uint8_t cnx_clamp_add_u8(uint8_t a, uint32_t b) {
    if (b > (uint32_t)(UINT8_MAX - a)) return UINT8_MAX;
    return (uint8_t)(a + (uint8_t)b);
}

static inline uint32_t cnx_clamp_sub_u32(uint32_t a, uint64_t b) {
    if (b > (uint64_t)a) return 0;
    return (uint32_t)(a - (uint32_t)b);
}

volatile uint32_t counter = 0U;

volatile uint8_t small = 250U;

volatile uint16_t bits = 0x00F0U;

void increment(void) {
    {
        uint32_t __old;
        uint32_t __new;
        __atomic_load(&counter, &__old, __ATOMIC_RELAXED);
        do {
            __new = cnx_clamp_add_u32(__old, 1U);
        } while (!__atomic_compare_exchange(&counter, &__old, &__new, 0, __ATOMIC_SEQ_CST, __ATOMIC_RELAXED));
    }
}

int main(void) {
    increment();
    increment();
    if (counter != 2) {
        return 1U;
    }
    {
        uint32_t __old;
        uint32_t __new;
        __atomic_load(&counter, &__old, __ATOMIC_RELAXED);
        do {
            __new = cnx_clamp_sub_u32(__old, 1U);
        } while (!__atomic_compare_exchange(&counter, &__old, &__new, 0, __ATOMIC_SEQ_CST, __ATOMIC_RELAXED));
    }
    if (counter != 1) {
        return 2U;
    }
    {
        uint8_t __old;
        uint8_t __new;
        __atomic_load(&small, &__old, __ATOMIC_RELAXED);
        do {
            __new = cnx_clamp_add_u8(__old, 10U);
        } while (!__atomic_compare_exchange(&small, &__old, &__new, 0, __ATOMIC_SEQ_CST, __ATOMIC_RELAXED));
    }
    if (small != 255) {
        return 3U;
    }
    {
        uint16_t __old;
        uint16_t __new;
        __atomic_load(&bits, &__old, __ATOMIC_RELAXED);
        do {
            __new = __old | 0x0F00U;
        } while (!__atomic_compare_exchange(&bits, &__old, &__new, 0, __ATOMIC_SEQ_CST, __ATOMIC_RELAXED));
    }
    if (bits != 0x0FF0) {
        return 4U;
    }
    {
        uint16_t __old;
        uint16_t __new;
        __atomic_load(&bits, &__old, __ATOMIC_RELAXED);
        do {
            __new = __old & 0x0F0FU;
        } while (!__atomic_compare_exchange(&bits, &__old, &__new, 0, __ATOMIC_SEQ_CST, __ATOMIC_RELAXED));
    }
    if (bits != 0x0F00) {
        return 5U;
    }
    return 0U;
}
