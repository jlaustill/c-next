/**
 * Generated by C-Next Transpiler from: atomic-whole-bitmap-host.test.cnx
 * A safer C for embedded systems
 * Requires: C99.
 * GNU/Clang extensions: GNU __atomic builtins.
 */

#include "atomic-whole-bitmap-host.test.h"


#include <stdint.h>
#include <stdbool.h>

// test-execution
// test-adr: 049
// #2245: a compound write to a whole `atomic` bitmap is a read-modify-write
// of its backing integer, as a write to one of its fields is. On host both
// are compare-exchange loops on `uint16_t`; `main` crashed here with
// "reading 'split'". The non-atomic bitmap is the control: plain C.
volatile F fl = {0};

F pl = {0};

void set(const uint8_t m) {
    {
        /* ADR-049 / Issue #1789: atomic read-modify-write as a compare-exchange retry loop, for a target with neither LDREX/STREX nor an interrupt mask. The GNU __atomic builtins are a compiler extension (MISRA C:2012 Rule 1.2). The value is evaluated once, before the loop, so a failed exchange does not evaluate it again (Issue #1807). */
        uint16_t __operand = 1;
        uint16_t __old;
        uint16_t __new;
        __atomic_load(&fl, &__old, __ATOMIC_RELAXED);
        do {
            __new = __old + __operand;
        } while (!__atomic_compare_exchange(&fl, &__old, &__new, 0, __ATOMIC_SEQ_CST, __ATOMIC_RELAXED));
    }
    {
        /* ADR-049 / Issue #1789: atomic read-modify-write as a compare-exchange retry loop, for a target with neither LDREX/STREX nor an interrupt mask. The GNU __atomic builtins are a compiler extension (MISRA C:2012 Rule 1.2). The value is evaluated once, before the loop, so a failed exchange does not evaluate it again (Issue #1807). */
        uint8_t __operand = m;
        uint16_t __old;
        uint16_t __new;
        __atomic_load(&fl, &__old, __ATOMIC_RELAXED);
        do {
            __new = (uint16_t)((__old & ~(0x7U << 1)) | ((__operand & 0x7U) << 1));
        } while (!__atomic_compare_exchange(&fl, &__old, &__new, 0, __ATOMIC_SEQ_CST, __ATOMIC_RELAXED));
    }
    pl += 1;
    pl = (uint16_t)((pl & ~(0x7U << 1)) | ((m & 0x7U) << 1));
}

int main(void) {
    set(2U);
    if (((fl >> 0) & 1) != true) {
        return 1U;
    }
    if (((fl >> 1) & 0x7) != 2) {
        return 2U;
    }
    if (((pl >> 0) & 1) != true) {
        return 3U;
    }
    if (((pl >> 1) & 0x7) != 2) {
        return 4U;
    }
    return 0U;
}
