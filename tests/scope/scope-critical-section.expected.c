/**
 * Generated by C-Next Transpiler
 * A safer C for embedded systems
 */

#include "scope-critical-section.test.h"

#include <stdint.h>
#include <stdbool.h>

// ADR-050: Platform-portable IRQ wrappers for critical sections
#if defined(__arm__) || defined(__ARM_ARCH)
// ARM platforms (including ARM Arduino like Teensy 4.x, Due, Zero)
// Provide inline assembly PRIMASK access to avoid CMSIS header dependencies
__attribute__((always_inline)) static inline uint32_t __cnx_get_PRIMASK(void) {
    uint32_t result;
    __asm volatile ("MRS %0, primask" : "=r" (result));
    return result;
}
__attribute__((always_inline)) static inline void __cnx_set_PRIMASK(uint32_t mask) {
    __asm volatile ("MSR primask, %0" :: "r" (mask) : "memory");
}
#if defined(ARDUINO)
static inline void __cnx_disable_irq(void) { noInterrupts(); }
#else
__attribute__((always_inline)) static inline void __cnx_disable_irq(void) {
    __asm volatile ("cpsid i" ::: "memory");
}
#endif
#elif defined(__AVR__)
// AVR Arduino: use SREG for interrupt state
// Note: Uses PRIMASK naming for API consistency across platforms (AVR has no PRIMASK)
// Returns uint8_t which is implicitly widened to uint32_t at call sites - this is intentional
static inline uint8_t __cnx_get_PRIMASK(void) { return SREG; }
static inline void __cnx_set_PRIMASK(uint8_t mask) { SREG = mask; }
static inline void __cnx_disable_irq(void) { cli(); }
#else
// Fallback: assume CMSIS is available
static inline void __cnx_disable_irq(void) { __disable_irq(); }
static inline uint32_t __cnx_get_PRIMASK(void) { return __get_PRIMASK(); }
static inline void __cnx_set_PRIMASK(uint32_t mask) { __set_PRIMASK(mask); }
#endif

// ADR-044: Overflow helper functions
#include <limits.h>

static inline uint32_t cnx_clamp_add_u32(uint32_t a, uint64_t b) {
    if (b > (uint64_t)(UINT32_MAX - a)) return UINT32_MAX;
    uint32_t result;
    if (__builtin_add_overflow(a, (uint32_t)b, &result)) return UINT32_MAX;
    return result;
}

static inline uint8_t cnx_clamp_add_u8(uint8_t a, uint32_t b) {
    if (b > (uint32_t)(UINT8_MAX - a)) return UINT8_MAX;
    uint8_t result;
    if (__builtin_add_overflow(a, (uint8_t)b, &result)) return UINT8_MAX;
    return result;
}

static inline uint8_t cnx_clamp_sub_u8(uint8_t a, uint32_t b) {
    if (b > (uint32_t)a) return 0;
    uint8_t result;
    if (__builtin_sub_overflow(a, (uint8_t)b, &result)) return 0;
    return result;
}

// test-c-only
// Test: ADR-016 + ADR-050 Critical sections inside scope methods
// Verifies that critical { } blocks work correctly inside scope methods
// Tests: public method with critical, private method with critical, this. inside critical, global. inside critical
// Global variables for testing global. accessor inside critical sections
uint8_t globalSharedBuffer[16] = {0};

uint32_t globalWriteIndex = 0U;

uint32_t globalReadIndex = 0U;

bool globalBufferLock = false;

/* Scope: CriticalTest */
static uint8_t CriticalTest_buffer[32] = {0};
static uint32_t CriticalTest_writeIndex = 0U;
static uint32_t CriticalTest_readIndex = 0U;
static uint8_t CriticalTest_count = 0U;
static bool CriticalTest_locked = false;

static void CriticalTest_internalEnqueue(uint8_t data) {
    {
        uint32_t __primask = __cnx_get_PRIMASK();
        __cnx_disable_irq();
        CriticalTest_buffer[CriticalTest_writeIndex] = data;
        CriticalTest_writeIndex = cnx_clamp_add_u32(CriticalTest_writeIndex, 1U);
        CriticalTest_count = cnx_clamp_add_u8(CriticalTest_count, 1U);
        __cnx_set_PRIMASK(__primask);
    }
}

static uint8_t CriticalTest_internalDequeue(void) {
    uint8_t result = 0U;
    {
        uint32_t __primask = __cnx_get_PRIMASK();
        __cnx_disable_irq();
        if (CriticalTest_count > 0) {
            result = CriticalTest_buffer[CriticalTest_readIndex];
            CriticalTest_readIndex = cnx_clamp_add_u32(CriticalTest_readIndex, 1U);
            CriticalTest_count = cnx_clamp_sub_u8(CriticalTest_count, 1U);
        }
        __cnx_set_PRIMASK(__primask);
    }
    return result;
}

static void CriticalTest_internalUpdateGlobal(void) {
    {
        uint32_t __primask = __cnx_get_PRIMASK();
        __cnx_disable_irq();
        globalWriteIndex = cnx_clamp_add_u32(globalWriteIndex, 1U);
        globalBufferLock = true;
        __cnx_set_PRIMASK(__primask);
    }
}

static void CriticalTest_internalTransfer(void) {
    {
        uint32_t __primask = __cnx_get_PRIMASK();
        __cnx_disable_irq();
        uint8_t data = CriticalTest_buffer[CriticalTest_readIndex];
        globalSharedBuffer[globalWriteIndex] = data;
        CriticalTest_readIndex = cnx_clamp_add_u32(CriticalTest_readIndex, 1U);
        globalWriteIndex = cnx_clamp_add_u32(globalWriteIndex, 1U);
        __cnx_set_PRIMASK(__primask);
    }
}

static bool CriticalTest_internalTryLock(void) {
    bool acquired = false;
    {
        uint32_t __primask = __cnx_get_PRIMASK();
        __cnx_disable_irq();
        if (!CriticalTest_locked) {
            CriticalTest_locked = true;
            acquired = true;
        }
        __cnx_set_PRIMASK(__primask);
    }
    return acquired;
}

static void CriticalTest_internalUnlock(void) {
    {
        uint32_t __primask = __cnx_get_PRIMASK();
        __cnx_disable_irq();
        CriticalTest_locked = false;
        __cnx_set_PRIMASK(__primask);
    }
}

void CriticalTest_enqueue(uint8_t data) {
    {
        uint32_t __primask = __cnx_get_PRIMASK();
        __cnx_disable_irq();
        CriticalTest_buffer[CriticalTest_writeIndex] = data;
        CriticalTest_writeIndex = cnx_clamp_add_u32(CriticalTest_writeIndex, 1U);
        CriticalTest_count = cnx_clamp_add_u8(CriticalTest_count, 1U);
        __cnx_set_PRIMASK(__primask);
    }
}

uint8_t CriticalTest_dequeue(void) {
    uint8_t result = 0U;
    {
        uint32_t __primask = __cnx_get_PRIMASK();
        __cnx_disable_irq();
        if (CriticalTest_count > 0) {
            result = CriticalTest_buffer[CriticalTest_readIndex];
            CriticalTest_readIndex = cnx_clamp_add_u32(CriticalTest_readIndex, 1U);
            CriticalTest_count = cnx_clamp_sub_u8(CriticalTest_count, 1U);
        }
        __cnx_set_PRIMASK(__primask);
    }
    return result;
}

void CriticalTest_updateGlobalIndex(void) {
    {
        uint32_t __primask = __cnx_get_PRIMASK();
        __cnx_disable_irq();
        globalWriteIndex = cnx_clamp_add_u32(globalWriteIndex, 1U);
        globalReadIndex = cnx_clamp_add_u32(globalReadIndex, 1U);
        __cnx_set_PRIMASK(__primask);
    }
}

void CriticalTest_transferToGlobal(void) {
    {
        uint32_t __primask = __cnx_get_PRIMASK();
        __cnx_disable_irq();
        uint8_t data = CriticalTest_buffer[CriticalTest_readIndex];
        globalSharedBuffer[globalWriteIndex] = data;
        CriticalTest_readIndex = cnx_clamp_add_u32(CriticalTest_readIndex, 1U);
        CriticalTest_count = cnx_clamp_sub_u8(CriticalTest_count, 1U);
        globalWriteIndex = cnx_clamp_add_u32(globalWriteIndex, 1U);
        __cnx_set_PRIMASK(__primask);
    }
}

uint8_t CriticalTest_getCount(void) {
    uint8_t result = 0U;
    {
        uint32_t __primask = __cnx_get_PRIMASK();
        __cnx_disable_irq();
        result = CriticalTest_count;
        __cnx_set_PRIMASK(__primask);
    }
    return result;
}

bool CriticalTest_tryLock(void) {
    bool acquired = false;
    {
        uint32_t __primask = __cnx_get_PRIMASK();
        __cnx_disable_irq();
        if (!CriticalTest_locked) {
            CriticalTest_locked = true;
            acquired = true;
        }
        __cnx_set_PRIMASK(__primask);
    }
    return acquired;
}

void CriticalTest_unlock(void) {
    {
        uint32_t __primask = __cnx_get_PRIMASK();
        __cnx_disable_irq();
        CriticalTest_locked = false;
        __cnx_set_PRIMASK(__primask);
    }
}

bool CriticalTest_isLocked(void) {
    bool result = false;
    {
        uint32_t __primask = __cnx_get_PRIMASK();
        __cnx_disable_irq();
        result = CriticalTest_locked;
        __cnx_set_PRIMASK(__primask);
    }
    return result;
}

void CriticalTest_resetAll(void) {
    {
        uint32_t __primask = __cnx_get_PRIMASK();
        __cnx_disable_irq();
        CriticalTest_writeIndex = 0U;
        CriticalTest_readIndex = 0U;
        CriticalTest_count = 0U;
        CriticalTest_locked = false;
        __cnx_set_PRIMASK(__primask);
    }
}

bool CriticalTest_isInSync(void) {
    bool inSync = false;
    {
        uint32_t __primask = __cnx_get_PRIMASK();
        __cnx_disable_irq();
        inSync = CriticalTest_writeIndex == globalWriteIndex;
        __cnx_set_PRIMASK(__primask);
    }
    return inSync;
}

void CriticalTest_safeEnqueue(uint8_t data) {
    CriticalTest_internalEnqueue(data);
}

uint8_t CriticalTest_safeDequeue(void) {
    return CriticalTest_internalDequeue();
}

void CriticalTest_lockedEnqueue(uint8_t data) {
    CriticalTest_internalTryLock();
    CriticalTest_internalEnqueue(data);
    CriticalTest_internalUnlock();
}

int main(void) {
    CriticalTest_enqueue(42U);
    CriticalTest_enqueue(84U);
    CriticalTest_dequeue();
    CriticalTest_updateGlobalIndex();
    CriticalTest_transferToGlobal();
    CriticalTest_getCount();
    CriticalTest_isLocked();
    CriticalTest_tryLock();
    CriticalTest_unlock();
    CriticalTest_resetAll();
    CriticalTest_isInSync();
    CriticalTest_safeEnqueue(10U);
    CriticalTest_safeDequeue();
    CriticalTest_lockedEnqueue(20U);
}
