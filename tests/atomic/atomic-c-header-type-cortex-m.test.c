/**
 * generated by cnx from: atomic-c-header-type-cortex-m.test.cnx
 * A safer C for embedded systems
 * Requires: C99.
 * atomic read-modify-write requires CMSIS + ARMv7-M.
 * interrupt masking requires one of: ARMv7-M core + Arduino core, ARMv7-M core, avr-libc (by target).
 */

#include "atomic-c-header-type-cortex-m.test.h"

// test-adr: 049
// #2155 review 8: an `atomic` of a C header integer type, which has no
// cnx name, is atomic all the same. Its compound and bit writes take the
// masked region: LDREX/STREX names no header type. On `main` this emitted the
// masked region; an earlier head of #2155 wrote a plain `f += 1;`.
// The atomics are locals: a public global of a header type is #2248's.
#include "atomic-c-header-type.h"


#include <stdint.h>
#include <stdbool.h>
#include <cmsis_gcc.h>

// ADR-050: Platform-portable IRQ wrappers for critical sections
#if defined(__arm__) || defined(__ARM_ARCH)
// ARM platforms (including ARM Arduino like Teensy 4.x, Due, Zero)
// Provide inline assembly PRIMASK access to avoid CMSIS header dependencies
__attribute__((always_inline)) static inline uint32_t __cnx_get_PRIMASK(void) {
    uint32_t result;
    __asm volatile ("MRS %0, primask" : "=r" (result));
    return result;
}
__attribute__((always_inline)) static inline void __cnx_set_PRIMASK(uint32_t mask) {
    __asm volatile ("MSR primask, %0" :: "r" (mask) : "memory");
}
#if defined(ARDUINO)
static inline void __cnx_disable_irq(void) { noInterrupts(); }
#else
__attribute__((always_inline)) static inline void __cnx_disable_irq(void) {
    __asm volatile ("cpsid i" ::: "memory");
}
#endif
#elif defined(__AVR__)
// AVR Arduino: use SREG for interrupt state
// SREG is declared by avr-libc's <avr/io.h>, cli() by its <avr/interrupt.h>
#include <avr/io.h>
#include <avr/interrupt.h>
// Note: Uses PRIMASK naming for API consistency across platforms (AVR has no PRIMASK)
// Returns uint8_t which is implicitly widened to uint32_t at call sites - this is intentional
static inline uint8_t __cnx_get_PRIMASK(void) { return SREG; }
static inline void __cnx_set_PRIMASK(uint8_t mask) { SREG = mask; }
static inline void __cnx_disable_irq(void) { cli(); }
#else
#error "cnx: the IRQ wrappers have no arm for this compiler, so a critical section has no lowering (ADR-050)"
#endif

// ADR-044: Overflow helper functions
#include <limits.h>

/* ADR-044 / Issue #94: the second parameter is the WIDER type, not the value type.
   Narrowing it first would let an out-of-range operand truncate INTO range and defeat
   the check: cnx_clamp_add_u8(0, 256) must saturate to 255, but (uint8_t)256 is 0, so a
   uint8_t parameter would return 0 -- the opposite of saturation. */

static inline int16_t cnx_clamp_add_i16(int16_t a, int32_t b) {
    int32_t result = (int32_t)a + b;
    if (result > INT16_MAX) return INT16_MAX;
    if (result < INT16_MIN) return INT16_MIN;
    return (int16_t)result;
}

void bump(const uint8_t n) {
    volatile int_fast16_t f = 0;
    volatile int16_t control = 0;
    {
        uint32_t __primask = __cnx_get_PRIMASK();
        __cnx_disable_irq();
        f += 1;
        __cnx_set_PRIMASK(__primask);
    }
    {
        uint32_t __primask = __cnx_get_PRIMASK();
        __cnx_disable_irq();
        f = (int_fast16_t)((f & ~((uintmax_t)1U << 2)) | ((uintmax_t)1U << 2));
        __cnx_set_PRIMASK(__primask);
    }
    {
        uint32_t __primask = __cnx_get_PRIMASK();
        __cnx_disable_irq();
        f = (int_fast16_t)((f & ~((uintmax_t)0x7U << 4)) | ((n & (uintmax_t)0x7U) << 4));
        __cnx_set_PRIMASK(__primask);
    }
    {
        /* ADR-049 / Issue #1807: atomic read-modify-write as an LDREX/STREX retry loop. The value is evaluated once, before the loop, so a failed store-exclusive does not evaluate it again. MISRA C:2012 Rule 11.3 deviation (Issue #2208): the signed value is accessed through its same-width unsigned type, because CMSIS's __LDREXH/__STREXH take a pointer to uint16_t; C11 6.5p7 makes the access defined. */
        int32_t __operand = 1;
        do {
            int16_t __old = (int16_t)__LDREXH((volatile uint16_t *)&control);
            int16_t __new = cnx_clamp_add_i16(__old, __operand);
            if (__STREXH((uint16_t)__new, (volatile uint16_t *)&control) == 0) {
                break;
            }
        } while (1);
    }
}

int main(void) {
    bump(5U);
    return 0U;
}
