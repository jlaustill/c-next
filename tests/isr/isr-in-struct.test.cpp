/**
 * Generated by C-Next Transpiler from: isr-in-struct.test.cnx
 * A safer C for embedded systems
 */

#include "isr-in-struct.test.hpp"

#include <stdint.h>

// ADR-044: Overflow helper functions
#include <limits.h>

/* ADR-044 / Issue #94: the second parameter is the WIDER type, not the value type.
   Narrowing it first would let an out-of-range operand truncate INTO range and defeat
   the check: cnx_clamp_add_u8(0, 256) must saturate to 255, but (uint8_t)256 is 0, so a
   uint8_t parameter would return 0 -- the opposite of saturation. */

static inline uint32_t cnx_clamp_add_u32(uint32_t a, uint64_t b) {
    if (b > (uint64_t)(UINT32_MAX - a)) return UINT32_MAX;
    return (uint32_t)(a + (uint32_t)b);
}

// test-execution
// ADR-040: ISR as struct field
// Tests: storing ISR in struct, retrieving and invoking
// Global to track which handler was called
uint32_t structCallCount = 0U;

uint32_t structLastHandler = 0U;

// Handler functions
void structHandler1(void) {
    structCallCount = cnx_clamp_add_u32(structCallCount, 1U);
    structLastHandler = 1U;
}

void structHandler2(void) {
    structCallCount = cnx_clamp_add_u32(structCallCount, 1U);
    structLastHandler = 2U;
}

void structHandler3(void) {
    structCallCount = cnx_clamp_add_u32(structCallCount, 1U);
    structLastHandler = 3U;
}

// Struct with ISR fields
// Initialize struct with ISR values
void initStructHolder(IsrHolder& hld, ISR prim, ISR sec) {
    hld.primary = prim;
    hld.secondary = sec;
}

// Invoke ISR from struct field
void invokeStructHolder(const IsrHolder& hld) {
    hld.primary();
    hld.secondary();
}

int main(void) {
    IsrHolder holder = {};
    holder.primary = structHandler1;
    holder.secondary = structHandler1;
    structCallCount = 0U;
    structLastHandler = 0U;
    holder.primary = structHandler1;
    holder.primary();
    if (structCallCount != 1) return 1;
    if (structLastHandler != 1) return 2;
    structCallCount = 0U;
    structLastHandler = 0U;
    holder.secondary = structHandler2;
    holder.secondary();
    if (structCallCount != 1) return 3;
    if (structLastHandler != 2) return 4;
    structCallCount = 0U;
    structLastHandler = 0U;
    initStructHolder(holder, structHandler1, structHandler3);
    invokeStructHolder(holder);
    if (structCallCount != 2) return 5;
    if (structLastHandler != 3) return 6;
    structCallCount = 0U;
    holder.primary = structHandler2;
    holder.secondary = structHandler1;
    invokeStructHolder(holder);
    if (structCallCount != 2) return 7;
    if (structLastHandler != 1) return 8;
    structCallCount = 0U;
    structLastHandler = 0U;
    holder.primary = structHandler3;
    holder.primary();
    if (structCallCount != 1) return 9;
    if (structLastHandler != 3) return 10;
    return 0;
}
