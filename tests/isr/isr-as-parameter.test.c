/**
 * Generated by C-Next Transpiler
 * A safer C for embedded systems
 */

#include <stdint.h>

/* ADR-040: ISR function pointer type */
typedef void (*ISR)(void);

// ADR-044: Overflow helper functions
#include <limits.h>

static inline uint32_t cnx_clamp_add_u32(uint32_t a, uint64_t b) {
    if (b > (uint64_t)(UINT32_MAX - a)) return UINT32_MAX;
    uint32_t result;
    if (__builtin_add_overflow(a, (uint32_t)b, &result)) return UINT32_MAX;
    return result;
}

// test-execution
// ADR-040: ISR as function parameter
// Tests: passing ISR to functions and invoking through parameter
// Global to track which handler was called
uint32_t paramCallCount = 0U;

uint32_t paramLastHandler = 0U;

// Handler functions (void() compatible with ISR)
void paramHandler1(void) {
    paramCallCount = cnx_clamp_add_u32(paramCallCount, 1U);
    paramLastHandler = 1U;
}

void paramHandler2(void) {
    paramCallCount = cnx_clamp_add_u32(paramCallCount, 1U);
    paramLastHandler = 2U;
}

void paramHandler3(void) {
    paramCallCount = cnx_clamp_add_u32(paramCallCount, 1U);
    paramLastHandler = 3U;
}

// Function that accepts ISR as parameter and invokes it
void executeParamHandler(ISR cb) {
    (*cb)();
}

// Function that accepts ISR and invokes it multiple times
void executeParamMultiple(ISR fn, uint32_t times) {
    for (uint32_t i = 0; i < times; i += 1) {
        (*fn)();
    }
}

// Function that accepts two ISRs and invokes both
void executeParamBoth(ISR first, ISR second) {
    (*first)();
    (*second)();
}

int main(void) {
    paramCallCount = 0U;
    paramLastHandler = 0U;
    executeParamHandler(&paramHandler1);
    if (paramCallCount != 1) return 1;
    if (paramLastHandler != 1) return 2;
    paramCallCount = 0U;
    paramLastHandler = 0U;
    executeParamHandler(&paramHandler2);
    if (paramCallCount != 1) return 3;
    if (paramLastHandler != 2) return 4;
    paramCallCount = 0U;
    executeParamMultiple(&paramHandler1, 5U);
    if (paramCallCount != 5) return 5;
    paramCallCount = 0U;
    paramLastHandler = 0U;
    executeParamBoth(&paramHandler1, &paramHandler2);
    if (paramCallCount != 2) return 6;
    if (paramLastHandler != 2) return 7;
    paramCallCount = 0U;
    paramLastHandler = 0U;
    executeParamBoth(&paramHandler2, &paramHandler1);
    if (paramCallCount != 2) return 8;
    if (paramLastHandler != 1) return 9;
    paramCallCount = 0U;
    executeParamHandler(&paramHandler1);
    executeParamHandler(&paramHandler2);
    executeParamHandler(&paramHandler3);
    if (paramCallCount != 3) return 10;
    if (paramLastHandler != 3) return 11;
    return 0;
}
