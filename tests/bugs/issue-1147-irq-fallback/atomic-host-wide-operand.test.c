/**
 * generated by cnx from: atomic-host-wide-operand.test.cnx
 * A safer C for embedded systems
 * Requires: C99.
 * GNU/Clang extensions: GNU __atomic builtins.
 */

#include "atomic-host-wide-operand.test.h"

// test-execution
// #2120 review 2: a retry loop's single-evaluation temporary must not narrow
// the value before the clamp helper sees it. The helper takes the wider type
// (#94), so a saturating write of a value wider than the variable saturates,
// as the non-atomic form does. A wider float keeps its precision.

#include <stdint.h>

// ADR-044: Overflow helper functions
#include <limits.h>

/* ADR-044 / Issue #94: the second parameter is the WIDER type, not the value type.
   Narrowing it first would let an out-of-range operand truncate INTO range and defeat
   the check: cnx_clamp_add_u8(0, 256) must saturate to 255, but (uint8_t)256 is 0, so a
   uint8_t parameter would return 0 -- the opposite of saturation. */

static inline int8_t cnx_clamp_add_i8(int8_t a, int32_t b) {
    int32_t result = (int32_t)a + b;
    if (result > INT8_MAX) return INT8_MAX;
    if (result < INT8_MIN) return INT8_MIN;
    return (int8_t)result;
}

static inline uint8_t cnx_clamp_add_u8(uint8_t a, uint32_t b) {
    if (b > (uint32_t)(UINT8_MAX - a)) return UINT8_MAX;
    return (uint8_t)(a + (uint8_t)b);
}

static inline int8_t cnx_clamp_sub_i8(int8_t a, int32_t b) {
    int32_t result = (int32_t)a - b;
    if (result > INT8_MAX) return INT8_MAX;
    if (result < INT8_MIN) return INT8_MIN;
    return (int8_t)result;
}

static inline uint8_t cnx_clamp_sub_u8(uint8_t a, uint32_t b) {
    if (b > (uint32_t)a) return 0;
    return (uint8_t)(a - (uint8_t)b);
}

volatile uint8_t counter = 0U;

volatile uint8_t falling = 10U;

volatile int8_t signed_up = 0;

volatile int8_t signed_down = 0;

volatile float sum = 0.0;

uint8_t plain = 0U;

uint32_t big = 256U;

int32_t wide = 300;

double tiny = 0.1;

int main(void) {
    plain = cnx_clamp_add_u8(plain, big);
    if (plain != 255) {
        return 1U;
    }
    {
        /* ADR-049 / Issue #1789: atomic read-modify-write as a compare-exchange retry loop, for a target with neither LDREX/STREX nor an interrupt mask. The GNU __atomic builtins are a compiler extension (MISRA C:2012 Rule 1.2). The value is evaluated once, before the loop, so a failed exchange does not evaluate it again (Issue #1807). */
        uint32_t __operand = big;
        uint8_t __old;
        uint8_t __new;
        __atomic_load(&counter, &__old, __ATOMIC_RELAXED);
        do {
            __new = cnx_clamp_add_u8(__old, __operand);
        } while (!__atomic_compare_exchange(&counter, &__old, &__new, 0, __ATOMIC_SEQ_CST, __ATOMIC_RELAXED));
    }
    if (counter != 255) {
        return 2U;
    }
    {
        /* ADR-049 / Issue #1789: atomic read-modify-write as a compare-exchange retry loop, for a target with neither LDREX/STREX nor an interrupt mask. The GNU __atomic builtins are a compiler extension (MISRA C:2012 Rule 1.2). The value is evaluated once, before the loop, so a failed exchange does not evaluate it again (Issue #1807). */
        uint32_t __operand = big;
        uint8_t __old;
        uint8_t __new;
        __atomic_load(&falling, &__old, __ATOMIC_RELAXED);
        do {
            __new = cnx_clamp_sub_u8(__old, __operand);
        } while (!__atomic_compare_exchange(&falling, &__old, &__new, 0, __ATOMIC_SEQ_CST, __ATOMIC_RELAXED));
    }
    if (falling != 0) {
        return 3U;
    }
    {
        /* ADR-049 / Issue #1789: atomic read-modify-write as a compare-exchange retry loop, for a target with neither LDREX/STREX nor an interrupt mask. The GNU __atomic builtins are a compiler extension (MISRA C:2012 Rule 1.2). The value is evaluated once, before the loop, so a failed exchange does not evaluate it again (Issue #1807). */
        int32_t __operand = wide;
        int8_t __old;
        int8_t __new;
        __atomic_load(&signed_up, &__old, __ATOMIC_RELAXED);
        do {
            __new = cnx_clamp_add_i8(__old, __operand);
        } while (!__atomic_compare_exchange(&signed_up, &__old, &__new, 0, __ATOMIC_SEQ_CST, __ATOMIC_RELAXED));
    }
    if (signed_up != 127) {
        return 4U;
    }
    {
        /* ADR-049 / Issue #1789: atomic read-modify-write as a compare-exchange retry loop, for a target with neither LDREX/STREX nor an interrupt mask. The GNU __atomic builtins are a compiler extension (MISRA C:2012 Rule 1.2). The value is evaluated once, before the loop, so a failed exchange does not evaluate it again (Issue #1807). */
        int32_t __operand = wide;
        int8_t __old;
        int8_t __new;
        __atomic_load(&signed_down, &__old, __ATOMIC_RELAXED);
        do {
            __new = cnx_clamp_sub_i8(__old, __operand);
        } while (!__atomic_compare_exchange(&signed_down, &__old, &__new, 0, __ATOMIC_SEQ_CST, __ATOMIC_RELAXED));
    }
    if (signed_down != -128) {
        return 5U;
    }
    {
        /* ADR-049 / Issue #1789: atomic read-modify-write as a compare-exchange retry loop, for a target with neither LDREX/STREX nor an interrupt mask. The GNU __atomic builtins are a compiler extension (MISRA C:2012 Rule 1.2). The value is evaluated once, before the loop, so a failed exchange does not evaluate it again (Issue #1807). */
        double __operand = tiny;
        float __old;
        float __new;
        __atomic_load(&sum, &__old, __ATOMIC_RELAXED);
        do {
            __new = __old + __operand;
        } while (!__atomic_compare_exchange(&sum, &__old, &__new, 0, __ATOMIC_SEQ_CST, __ATOMIC_RELAXED));
    }
    if (sum != (float)0.1) {
        return 6U;
    }
    return 0U;
}
