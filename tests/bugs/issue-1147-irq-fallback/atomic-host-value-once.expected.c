/**
 * generated by cnx from: atomic-host-value-once.test.cnx
 * A safer C for embedded systems
 * Requires: C99.
 * GNU/Clang extensions: GNU __atomic builtins.
 */

#include "atomic-host-value-once.test.h"

// test-execution
// #1789 review, #1807: a compare-exchange retry loop evaluates its value once.
// step() changes counter itself, so the first exchange fails. A loop that
// evaluated the value on every attempt would call step() twice.

#include <stdint.h>

// ADR-044: Overflow helper functions
#include <limits.h>

/* ADR-044 / Issue #94: the second parameter is the WIDER type, not the value type.
   Narrowing it first would let an out-of-range operand truncate INTO range and defeat
   the check: cnx_clamp_add_u8(0, 256) must saturate to 255, but (uint8_t)256 is 0, so a
   uint8_t parameter would return 0 -- the opposite of saturation. */

static inline uint32_t cnx_clamp_add_u32(uint32_t a, uint64_t b) {
    if (b > (uint64_t)(UINT32_MAX - a)) return UINT32_MAX;
    return (uint32_t)(a + (uint32_t)b);
}

volatile uint32_t counter = 0U;

uint32_t calls = 0U;

uint32_t step(void) {
    calls = cnx_clamp_add_u32(calls, 1U);
    counter = 10U;
    return 1U;
}

int main(void) {
    {
        /* ADR-049 / Issue #1789: atomic read-modify-write as a compare-exchange retry loop, for a target with neither LDREX/STREX nor an interrupt mask. The GNU __atomic builtins are a compiler extension (MISRA C:2012 Rule 1.2). The value is evaluated once, before the loop, so a failed exchange does not evaluate it again (Issue #1807). */
        uint64_t __operand = step();
        uint32_t __old;
        uint32_t __new;
        __atomic_load(&counter, &__old, __ATOMIC_RELAXED);
        do {
            __new = cnx_clamp_add_u32(__old, __operand);
        } while (!__atomic_compare_exchange(&counter, &__old, &__new, 0, __ATOMIC_SEQ_CST, __ATOMIC_RELAXED));
    }
    if (calls != 1) {
        return 1U;
    }
    if (counter != 11) {
        return 2U;
    }
    return 0U;
}
