/**
 * Generated by C-Next Transpiler from: atomic-c-header-type-host.test.cnx
 * A safer C for embedded systems
 * Requires: C99.
 * GNU/Clang extensions: GNU __atomic builtins.
 */

// test-execution
// test-adr: 049
// #2155 review 8: on a target with no interrupt mask, an `atomic` of a C
// header integer type is a compare-exchange loop in its C type. `main`
// crashed on this compound write; an earlier head of #2155 wrote it plainly.
// The atomic is a local: a public global of a header type is #2248's.
#include "atomic-c-header-type.h"


#include <stdint.h>
#include <stdbool.h>

int main(void) {
    volatile int_fast16_t f = 0;
    {
        /* ADR-049 / Issue #1789: atomic read-modify-write as a compare-exchange retry loop, for a target with neither LDREX/STREX nor an interrupt mask. The GNU __atomic builtins are a compiler extension (MISRA C:2012 Rule 1.2). The value is evaluated once, before the loop, so a failed exchange does not evaluate it again (Issue #1807). */
        uint16_t __operand = 3;
        int_fast16_t __old;
        int_fast16_t __new;
        __atomic_load(&f, &__old, __ATOMIC_RELAXED);
        do {
            __new = __old + __operand;
        } while (!__atomic_compare_exchange(&f, &__old, &__new, 0, __ATOMIC_SEQ_CST, __ATOMIC_RELAXED));
    }
    if (f != 3) {
        return 1U;
    }
    {
        /* ADR-049 / Issue #1789: atomic read-modify-write as a compare-exchange retry loop, for a target with neither LDREX/STREX nor an interrupt mask. The GNU __atomic builtins are a compiler extension (MISRA C:2012 Rule 1.2). The value is evaluated once, before the loop, so a failed exchange does not evaluate it again (Issue #1807). */
        bool __operand = true;
        int_fast16_t __old;
        int_fast16_t __new;
        __atomic_load(&f, &__old, __ATOMIC_RELAXED);
        do {
            __new = (int_fast16_t)((__old & ~((uintmax_t)1U << 4)) | ((uintmax_t)(__operand ? 1U : 0U) << 4));
        } while (!__atomic_compare_exchange(&f, &__old, &__new, 0, __ATOMIC_SEQ_CST, __ATOMIC_RELAXED));
    }
    if (f != 19) {
        return 2U;
    }
    {
        /* ADR-049 / Issue #1789: atomic read-modify-write as a compare-exchange retry loop, for a target with neither LDREX/STREX nor an interrupt mask. The GNU __atomic builtins are a compiler extension (MISRA C:2012 Rule 1.2). The value is evaluated once, before the loop, so a failed exchange does not evaluate it again (Issue #1807). */
        uint16_t __operand = 0U;
        int_fast16_t __old;
        int_fast16_t __new;
        __atomic_load(&f, &__old, __ATOMIC_RELAXED);
        do {
            __new = (int_fast16_t)((__old & ~((uintmax_t)0x3U << 0)) | ((__operand & (uintmax_t)0x3U) << 0));
        } while (!__atomic_compare_exchange(&f, &__old, &__new, 0, __ATOMIC_SEQ_CST, __ATOMIC_RELAXED));
    }
    if (f != 16) {
        return 3U;
    }
    return 0U;
}
