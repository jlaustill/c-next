/**
 * Generated by C-Next Transpiler from: critical-in-loop.test.cnx
 * A safer C for embedded systems
 */

#include <stdint.h>

// ADR-050: Platform-portable IRQ wrappers for critical sections
#if defined(__arm__) || defined(__ARM_ARCH)
// ARM platforms (including ARM Arduino like Teensy 4.x, Due, Zero)
// Provide inline assembly PRIMASK access to avoid CMSIS header dependencies
__attribute__((always_inline)) static inline uint32_t __cnx_get_PRIMASK(void) {
    uint32_t result;
    __asm volatile ("MRS %0, primask" : "=r" (result));
    return result;
}
__attribute__((always_inline)) static inline void __cnx_set_PRIMASK(uint32_t mask) {
    __asm volatile ("MSR primask, %0" :: "r" (mask) : "memory");
}
#if defined(ARDUINO)
static inline void __cnx_disable_irq(void) { noInterrupts(); }
#else
__attribute__((always_inline)) static inline void __cnx_disable_irq(void) {
    __asm volatile ("cpsid i" ::: "memory");
}
#endif
#elif defined(__AVR__)
// AVR Arduino: use SREG for interrupt state
// Note: Uses PRIMASK naming for API consistency across platforms (AVR has no PRIMASK)
// Returns uint8_t which is implicitly widened to uint32_t at call sites - this is intentional
static inline uint8_t __cnx_get_PRIMASK(void) { return SREG; }
static inline void __cnx_set_PRIMASK(uint8_t mask) { SREG = mask; }
static inline void __cnx_disable_irq(void) { cli(); }
#else
// Fallback: assume CMSIS is available
static inline void __cnx_disable_irq(void) { __disable_irq(); }
static inline uint32_t __cnx_get_PRIMASK(void) { return __get_PRIMASK(); }
static inline void __cnx_set_PRIMASK(uint32_t mask) { __set_PRIMASK(mask); }
#endif

// ADR-044: Overflow helper functions
#include <limits.h>

static inline uint32_t cnx_clamp_add_u32(uint32_t a, uint64_t b) {
    if (b > (uint64_t)(UINT32_MAX - a)) return UINT32_MAX;
    uint32_t result;
    if (__builtin_add_overflow(a, (uint32_t)b, &result)) return UINT32_MAX;
    return result;
}

// test-c-only
// test-coverage: 33.2-critical-inside-loop
// Coverage: Section 7.7, 33.2 - Critical section inside loops
// Tests: critical sections inside for, while, and do-while loops
uint32_t sharedData[10] = {0};

uint32_t counter = 0U;

void criticalInFor(void) {
    for (uint32_t i = 0; i < 10; i = i + 1) {
        {
            uint32_t __primask = __cnx_get_PRIMASK();
            __cnx_disable_irq();
            sharedData[i] = i * 2U;
            counter = cnx_clamp_add_u32(counter, 1U);
            __cnx_set_PRIMASK(__primask);
        }
    }
}

void criticalInWhile(void) {
    uint32_t i = 0U;
    while (i < 5) {
        {
            uint32_t __primask = __cnx_get_PRIMASK();
            __cnx_disable_irq();
            sharedData[i] += 1U;
            __cnx_set_PRIMASK(__primask);
        }
        i = cnx_clamp_add_u32(i, 1U);
    }
}

void criticalInDoWhile(void) {
    uint32_t i = 0U;
    do {
        {
            uint32_t __primask = __cnx_get_PRIMASK();
            __cnx_disable_irq();
            counter = cnx_clamp_add_u32(counter, 1U);
            __cnx_set_PRIMASK(__primask);
        }
        i = cnx_clamp_add_u32(i, 1U);
    } while (i < 3);
}

void criticalInNestedLoop(void) {
    for (uint32_t i = 0; i < 3; i = i + 1) {
        for (uint32_t j = 0; j < 3; j = j + 1) {
            {
                uint32_t __primask = __cnx_get_PRIMASK();
                __cnx_disable_irq();
                sharedData[i] += j;
                __cnx_set_PRIMASK(__primask);
            }
        }
    }
}

int main(void) {
    criticalInFor();
    criticalInWhile();
    criticalInDoWhile();
    criticalInNestedLoop();
}
