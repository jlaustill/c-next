/**
 * generated by cnx from: callback-local-nested.test.cnx
 * A safer C for embedded systems
 */

#include "callback-local-nested.test.hpp"

#include <stdint.h>

// ADR-044: Overflow helper functions
#include <limits.h>

/* ADR-044 / Issue #94: the second parameter is the WIDER type, not the value type.
   Narrowing it first would let an out-of-range operand truncate INTO range and defeat
   the check: cnx_clamp_add_u8(0, 256) must saturate to 255, but (uint8_t)256 is 0, so a
   uint8_t parameter would return 0 -- the opposite of saturation. */

static inline uint32_t cnx_clamp_add_u32(uint32_t a, uint64_t b) {
    if (b > (uint64_t)(UINT32_MAX - a)) return UINT32_MAX;
    return (uint32_t)(a + (uint32_t)b);
}

// test-execution
// #1484 / #1951 review / #1960 review: a callback-typed local nested in each
// statement kind the pre-pass walks still gets its `_fp` typedef. Each kind
// uses its own callback type, so dropping any one arm of the walk loses
// exactly one typedef and the C no longer compiles. `critical` is in
// callback-local-critical, which cannot run on host until #1147.
uint32_t total = 0U;


typedef void (*onIf_fp)(const uint32_t);
typedef void (*onWhile_fp)(const uint32_t);
typedef void (*onDo_fp)(const uint32_t);
typedef void (*onFor_fp)(const uint32_t);
typedef void (*onCase_fp)(const uint32_t);
typedef void (*onDefault_fp)(const uint32_t);
typedef void (*onForever_fp)(const uint32_t);

void onIf(const uint32_t n) {
    total = cnx_clamp_add_u32(total, n);
}

void onWhile(const uint32_t n) {
    total = cnx_clamp_add_u32(total, n);
}

void onDo(const uint32_t n) {
    total = cnx_clamp_add_u32(total, n);
}

void onFor(const uint32_t n) {
    total = cnx_clamp_add_u32(total, n);
}

void onCase(const uint32_t n) {
    total = cnx_clamp_add_u32(total, n);
}

void onDefault(const uint32_t n) {
    total = cnx_clamp_add_u32(total, n);
}

void onForever(const uint32_t n) {
    total = cnx_clamp_add_u32(total, n);
}

// A forever loop is only legal in a void function (E0705).
void spinOnce(void) {
    /* MISRA C:2012 Rule 14.3: infinite loop written as `for (;;)` for cnx `forever` (`while (1)` has a controlling expression with an invariant value, which the rule forbids). */
    for (;;) {
        const onForever_fp spin = onForever;
        spin(1U);
        return;
    }
}

int main(void) {
    if (total == 0) {
        const onIf_fp handler = onIf;
        handler(5U);
    }
    if (total != 5) {
        return 1U;
    }
    uint32_t i = 0U;
    while (i < 1) {
        const onWhile_fp beat = onWhile;
        beat(2U);
        i = cnx_clamp_add_u32(i, 1U);
    }
    if (total != 7) {
        return 2U;
    }
    do {
        const onDo_fp step = onDo;
        step(1U);
    } while (total < 8);
    if (total != 8) {
        return 3U;
    }
    for (uint32_t j = 0U; j < 1; j = cnx_clamp_add_u32(j, 1U)) {
        const onFor_fp tick = onFor;
        tick(2U);
    }
    if (total != 10) {
        return 4U;
    }
    switch (total) {
        case 10: {
            const onCase_fp matched = onCase;
            matched(1U);
            break;
        }
        default: {
            const onDefault_fp unmatched = onDefault;
            unmatched(100U);
            break;
        }
    }
    if (total != 11) {
        return 5U;
    }
    switch (total) {
        case 0: {
            const onCase_fp never = onCase;
            never(100U);
            break;
        }
        default: {
            const onDefault_fp fallback = onDefault;
            fallback(1U);
            break;
        }
    }
    if (total != 12) {
        return 6U;
    }
    spinOnce();
    if (total != 13) {
        return 7U;
    }
    return 0U;
}
