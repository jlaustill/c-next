/**
 * Generated by C-Next Transpiler from: atomic-extern-edge-cases.test.cnx
 * A safer C for embedded systems
 * Requires: C99.
 * atomic read-modify-write requires CMSIS + ARMv7-M.
 * interrupt masking requires one of: ARMv7-M core + Arduino core, ARMv7-M core, avr-libc, CMSIS (by target).
 */

#include "atomic-extern-edge-cases.test.h"

// test-c-only
// test-coverage: atomic-extern-edge-cases
// Tests: edge cases for atomic volatile qualifier in extern declarations
// Bug #468: Comprehensive coverage to prevent regression

#include <stdint.h>
#include <stdbool.h>
#include <string.h>
#include <cmsis_gcc.h>

// ADR-050: Platform-portable IRQ wrappers for critical sections
#if defined(__arm__) || defined(__ARM_ARCH)
// ARM platforms (including ARM Arduino like Teensy 4.x, Due, Zero)
// Provide inline assembly PRIMASK access to avoid CMSIS header dependencies
__attribute__((always_inline)) static inline uint32_t __cnx_get_PRIMASK(void) {
    uint32_t result;
    __asm volatile ("MRS %0, primask" : "=r" (result));
    return result;
}
__attribute__((always_inline)) static inline void __cnx_set_PRIMASK(uint32_t mask) {
    __asm volatile ("MSR primask, %0" :: "r" (mask) : "memory");
}
#if defined(ARDUINO)
static inline void __cnx_disable_irq(void) { noInterrupts(); }
#else
__attribute__((always_inline)) static inline void __cnx_disable_irq(void) {
    __asm volatile ("cpsid i" ::: "memory");
}
#endif
#elif defined(__AVR__)
// AVR Arduino: use SREG for interrupt state
// SREG is declared by avr-libc's <avr/io.h>, cli() by its <avr/interrupt.h>
#include <avr/io.h>
#include <avr/interrupt.h>
// Note: Uses PRIMASK naming for API consistency across platforms (AVR has no PRIMASK)
// Returns uint8_t which is implicitly widened to uint32_t at call sites - this is intentional
static inline uint8_t __cnx_get_PRIMASK(void) { return SREG; }
static inline void __cnx_set_PRIMASK(uint8_t mask) { SREG = mask; }
static inline void __cnx_disable_irq(void) { cli(); }
#else
// Fallback: assume CMSIS is available
static inline void __cnx_disable_irq(void) { __disable_irq(); }
static inline uint32_t __cnx_get_PRIMASK(void) { return __get_PRIMASK(); }
static inline void __cnx_set_PRIMASK(uint32_t mask) { __set_PRIMASK(mask); }
#endif

// ADR-044: Overflow helper functions
#include <limits.h>

/* ADR-044 / Issue #94: the second parameter is the WIDER type, not the value type.
   Narrowing it first would let an out-of-range operand truncate INTO range and defeat
   the check: cnx_clamp_add_u8(0, 256) must saturate to 255, but (uint8_t)256 is 0, so a
   uint8_t parameter would return 0 -- the opposite of saturation. */

static inline int64_t cnx_clamp_add_i64(int64_t a, int64_t b) {
    if (b > 0 && a > INT64_MAX - b) return INT64_MAX;
    if (b < 0 && a < INT64_MIN - b) return INT64_MIN;
    return a + b;
}

static inline int8_t cnx_clamp_add_i8(int8_t a, int32_t b) {
    int32_t result = (int32_t)a + b;
    if (result > INT8_MAX) return INT8_MAX;
    if (result < INT8_MIN) return INT8_MIN;
    return (int8_t)result;
}

static inline uint64_t cnx_clamp_add_u64(uint64_t a, uint64_t b) {
    if (b > (uint64_t)(UINT64_MAX - a)) return UINT64_MAX;
    return (uint64_t)(a + (uint64_t)b);
}

// Edge case 1: atomic + const combination
const volatile uint32_t CONFIG = 42U;

// Edge case 2: atomic 2D array
volatile uint8_t matrix[4][4] = {0};

// Edge case 3: atomic i64 (signed 64-bit)
volatile int64_t bigSignedCounter = 0;

// Edge case 4: atomic u64 (unsigned 64-bit)
volatile uint64_t bigUnsignedCounter = 0ULL;

// Edge case 5: atomic string type
volatile char statusMessage[17] = "";

// Edge case 6: atomic struct (non-array)
volatile TStatus currentStatus = {0};

// Edge case 7: atomic with wrap + const (multiple modifiers)
volatile uint16_t sequence = 0U;

// Edge case 8: atomic with clamp (saturation)
volatile int8_t temperature = 0;

int main(void) {
    matrix[0][0] = 1U;
    {
        uint32_t __primask = __cnx_get_PRIMASK();
        __cnx_disable_irq();
        bigSignedCounter = cnx_clamp_add_i64(bigSignedCounter, 1);
        __cnx_set_PRIMASK(__primask);
    }
    {
        uint32_t __primask = __cnx_get_PRIMASK();
        __cnx_disable_irq();
        bigUnsignedCounter = cnx_clamp_add_u64(bigUnsignedCounter, 1ULL);
        __cnx_set_PRIMASK(__primask);
    }
    currentStatus.active = true;
    do {
        uint16_t __old = __LDREXH(&sequence);
        uint16_t __new = __old + 1U;
        if (__STREXH(__new, &sequence) == 0) {
            break;
        }
    } while (1);
    do {
        int8_t __old = __LDREXB(&temperature);
        int8_t __new = cnx_clamp_add_i8(__old, 10);
        if (__STREXB(__new, &temperature) == 0) {
            break;
        }
    } while (1);
}
