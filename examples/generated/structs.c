/**
 * generated by cnx from: structs.cnx
 * A safer C for embedded systems
 */

#include "structs.h"

// structs.cnx - Demonstrates struct features (ADR-014)
// Structs are pure data containers without methods
#include <stdint.h>
#include <stdbool.h>

// ADR-044: Overflow helper functions
#include <limits.h>

/* ADR-044 / Issue #94: the second parameter is the WIDER type, not the value type.
   Narrowing it first would let an out-of-range operand truncate INTO range and defeat
   the check: cnx_clamp_add_u8(0, 256) must saturate to 255, but (uint8_t)256 is 0, so a
   uint8_t parameter would return 0 -- the opposite of saturation. */

static inline int32_t cnx_clamp_add_i32(int32_t a, int64_t b) {
    int64_t result = (int64_t)a + b;
    if (result > INT32_MAX) return INT32_MAX;
    if (result < INT32_MIN) return INT32_MIN;
    return (int32_t)result;
}

static inline int32_t cnx_clamp_mul_i32(int32_t a, int64_t b) {
    int64_t result = (int64_t)a * b;
    if (result > INT32_MAX) return INT32_MAX;
    if (result < INT32_MIN) return INT32_MIN;
    return (int32_t)result;
}

static inline int32_t cnx_clamp_sub_i32(int32_t a, int64_t b) {
    int64_t result = (int64_t)a - b;
    if (result > INT32_MAX) return INT32_MAX;
    if (result < INT32_MIN) return INT32_MIN;
    return (int32_t)result;
}

// ============================================================================
// Simple Structs
// ============================================================================
// Basic 2D point
// 3D vector with floating point
// Color with alpha channel
// ============================================================================
// Configuration Structs
// ============================================================================
// UART configuration
// SPI configuration
// I2C configuration
// ============================================================================
// Composed Structs
// ============================================================================
// Rectangle defined by two points
// Circle defined by center and radius
// ============================================================================
// Console scope for output (ADR-016)
// ============================================================================
/* Scope: Console */

void Console__printInt(const int32_t value) {
}

void Console__printFloat(const float value) {
}

void Console__printHex(const uint32_t value) {
}

// ============================================================================
// Functions operating on structs (ADR-006: pass by reference)
// ============================================================================
// Move a point by delta values
// Input parameters are const (not modified), output parameter is not
void movePoint(Point* p, const int32_t dx, const int32_t dy) {
    p->x = cnx_clamp_add_i32(p->x, dx);
    p->y = cnx_clamp_add_i32(p->y, dy);
}

// Scale a point from origin
void scalePoint(Point* p, const int32_t factor) {
    p->x = cnx_clamp_mul_i32(p->x, factor);
    p->y = cnx_clamp_mul_i32(p->y, factor);
}

// Calculate distance squared between two points (no sqrt for embedded)
void distanceSquared(const Point* a, const Point* b, int32_t* result) {
    const int32_t dx = cnx_clamp_sub_i32(b->x, a->x);
    const int32_t dy = cnx_clamp_sub_i32(b->y, a->y);
    (*result) = cnx_clamp_add_i32(cnx_clamp_mul_i32(dx, dx), cnx_clamp_mul_i32(dy, dy));
}

// Normalize a vector (approximate for embedded - no floating point division)
void normalizeVector(const Vector3* v) {
    const float len = v->x * v->x + v->y * v->y + v->z * v->z;
}

// Check if a point is inside a rectangle
void isPointInRect(const Point* p, const Rectangle* rect, bool* result) {
    (*result) = p->x >= rect->topLeft.x && p->x <= rect->bottomRight.x && p->y >= rect->topLeft.y && p->y <= rect->bottomRight.y;
}

// ============================================================================
// Configuration constants (ADR-006: no magic numbers)
// ============================================================================
const int32_t MOVE_DX = 5;

const int32_t MOVE_DY = 10;

const int32_t SCALE_FACTOR = 2;

const uint32_t DEFAULT_BAUD = 115200U;

const uint8_t DEFAULT_DATA_BITS = 8U;

const uint8_t DEFAULT_STOP_BITS = 1U;

const uint8_t DEFAULT_PARITY = 0U;

const uint32_t SPI_CLOCK = 1000000U;

const uint8_t SPI_MODE = 0U;

const uint8_t SPI_BIT_ORDER = 0U;

// ============================================================================
// Main demonstration
// ============================================================================
int main(void) {
    const Point origin = {0};
    const Vector3 direction = {0};
    const UARTConfig uart = {0};
    Point cursor = { .x = 100, .y = 200 };
    const Color red = { .r = 255U };
    const Color blue = { .r = 0U, .g = 0U, .b = 255U, .a = 255U };
    const UARTConfig serialConfig = { .baudRate = DEFAULT_BAUD, .dataBits = DEFAULT_DATA_BITS, .stopBits = DEFAULT_STOP_BITS, .parity = DEFAULT_PARITY };
    const Rectangle rect = { .topLeft = { .x = 0, .y = 0 }, .bottomRight = { .x = 640, .y = 480 } };
    const Circle circle = { .center = { .x = 320, .y = 240 }, .radius = 100U };
    const int32_t cursorX = cursor.x;
    const int32_t cursorY = cursor.y;
    Console__printInt(cursorX);
    Console__printInt(cursorY);
    cursor.x = 150;
    cursor.y = 250;
    const int32_t rectWidth = cnx_clamp_sub_i32(rect.bottomRight.x, rect.topLeft.x);
    const int32_t rectHeight = cnx_clamp_sub_i32(rect.bottomRight.y, rect.topLeft.y);
    Console__printInt(rectWidth);
    Console__printInt(rectHeight);
    Point player = { .x = 10, .y = 20 };
    movePoint(&player, MOVE_DX, MOVE_DY);
    Console__printInt(player.x);
    Console__printInt(player.y);
    scalePoint(&player, SCALE_FACTOR);
    Console__printInt(player.x);
    Console__printInt(player.y);
    const Point target = { .x = 100, .y = 100 };
    int32_t dist = 0;
    distanceSquared(&player, &target, &dist);
    Console__printInt(dist);
    bool inside = false;
    isPointInRect(&player, &rect, &inside);
}
