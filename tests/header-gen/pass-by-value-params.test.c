/**
 * Generated by C-Next Transpiler from: pass-by-value-params.test.cnx
 * A safer C for embedded systems
 */

#include "pass-by-value-params.test.h"

#include <stdint.h>
#include <stdbool.h>

// Tests: Header generation with pass-by-value parameters
// Floats, enums, and ISR types should use pass-by-value, not pointers
/* Scope: Api */

float Api__addFloats(float a, float b) {
    return a + b;
}

bool Api__isOk(Status status) {
    return status == Status__Ok;
}

void Api__updateValue(uint32_t* value) {
    (*value) += 1U;
}

uint32_t Api__readValue(uint32_t value) {
    return value * 2;
}

int main(void) {
    float sum = Api__addFloats(1.5, 2.5);
    int32_t sumInt = (int32_t)sum;
    if (sumInt != 4) return 1;
    bool okResult = Api__isOk(Status__Ok);
    if (okResult == false) return 2;
    bool errResult = Api__isOk(Status__Error);
    if (errResult == true) return 3;
    uint32_t val = 10U;
    Api__updateValue(&val);
    if (val != 11) return 4;
    uint32_t doubled = Api__readValue(5U);
    if (doubled != 10) return 5;
    return 0;
}
