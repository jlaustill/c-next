/**
 * Generated by C-Next Transpiler
 * A safer C for embedded systems
 */

#include <stdint.h>

/* ADR-040: ISR function pointer type */
typedef void (*ISR)(void);

// ADR-044: Overflow helper functions
#include <limits.h>

static inline uint32_t cnx_clamp_add_u32(uint32_t a, uint64_t b) {
    if (b > UINT32_MAX - a) return UINT32_MAX;
    return a + (uint32_t)b;
}

/* test-execution */
// ADR-040: ISR as struct field
// Tests: storing ISR in struct, retrieving and invoking
// Global to track which handler was called
uint32_t structCallCount = 0;

uint32_t structLastHandler = 0;

// Handler functions
void structHandler1(void) {
    structCallCount = cnx_clamp_add_u32(structCallCount, 1);
    structLastHandler = 1;
}

void structHandler2(void) {
    structCallCount = cnx_clamp_add_u32(structCallCount, 1);
    structLastHandler = 2;
}

void structHandler3(void) {
    structCallCount = cnx_clamp_add_u32(structCallCount, 1);
    structLastHandler = 3;
}

// Struct with ISR fields
typedef struct {
    ISR primary;
    ISR secondary;
} IsrHolder;

// Initialize struct with ISR values
void initStructHolder(IsrHolder* hld, ISR prim, ISR sec) {
    hld->primary = (*prim);
    hld->secondary = (*sec);
}

// Invoke ISR from struct field
void invokeStructHolder(IsrHolder* hld) {
    hld->primary();
    hld->secondary();
}

int main(void) {
    IsrHolder holder = {0};
    holder.primary = structHandler1;
    holder.secondary = structHandler1;
    structCallCount = 0;
    structLastHandler = 0;
    holder.primary = structHandler1;
    holder.primary();
    if (structCallCount != 1) return 1;
    if (structLastHandler != 1) return 2;
    structCallCount = 0;
    structLastHandler = 0;
    holder.secondary = structHandler2;
    holder.secondary();
    if (structCallCount != 1) return 3;
    if (structLastHandler != 2) return 4;
    structCallCount = 0;
    structLastHandler = 0;
    initStructHolder(&holder, &structHandler1, &structHandler3);
    invokeStructHolder(&holder);
    if (structCallCount != 2) return 5;
    if (structLastHandler != 3) return 6;
    structCallCount = 0;
    holder.primary = structHandler2;
    holder.secondary = structHandler1;
    invokeStructHolder(&holder);
    if (structCallCount != 2) return 7;
    if (structLastHandler != 1) return 8;
    structCallCount = 0;
    structLastHandler = 0;
    holder.primary = structHandler3;
    holder.primary();
    if (structCallCount != 1) return 9;
    if (structLastHandler != 3) return 10;
    return 0;
}
