/**
 * Generated by C-Next Transpiler from: register-wo-operations.test.cnx
 * A safer C for embedded systems
 */

#include "register-wo-operations.test.h"

#include <stdint.h>
#include <stdbool.h>

// ADR-044: Overflow helper functions
#include <limits.h>

/* ADR-044 / Issue #94: the second parameter is the WIDER type, not the value type.
   Narrowing it first would let an out-of-range operand truncate INTO range and defeat
   the check: cnx_clamp_add_u8(0, 256) must saturate to 255, but (uint8_t)256 is 0, so a
   uint8_t parameter would return 0 -- the opposite of saturation. */

static inline uint32_t cnx_clamp_add_u32(uint32_t a, uint64_t b) {
    if (b > (uint64_t)(UINT32_MAX - a)) return UINT32_MAX;
    return (uint32_t)(a + (uint32_t)b);
}

static inline uint32_t cnx_clamp_mul_u32(uint32_t a, uint64_t b) {
    if (b != 0 && a > UINT32_MAX / b) return UINT32_MAX;
    return (uint32_t)(a * (uint32_t)b);
}

// ADR-004: Write-only register operations test
// Tests: Valid write-only register bit operations with various index types
// Coverage: Section 12 - Register Declaration (write-only bit access)
// Extracted from: write-only-register-chain.test.cnx.skip
/* Register: GPIO @ 0x42000000 */
#define GPIO__DR (*(volatile uint32_t*)(0x42000000 + 0x00))
#define GPIO__DR_SET (*(volatile uint32_t*)(0x42000000 + 0x84))
#define GPIO__DR_CLEAR (*(volatile uint32_t*)(0x42000000 + 0x88))
#define GPIO__DR_TOGGLE (*(volatile uint32_t*)(0x42000000 + 0x8C))

const uint32_t LED_BIT = 3U;

const uint32_t BUTTON_BIT = 7U;

uint32_t dynamicBit = 5U;

int main(void) {
    GPIO__DR_SET = (1U << 0);
    GPIO__DR_SET = (1U << 31);
    GPIO__DR_SET = (1U << LED_BIT);
    GPIO__DR_CLEAR = (1U << LED_BIT);
    GPIO__DR_TOGGLE = (1U << LED_BIT);
    GPIO__DR_SET = (1U << BUTTON_BIT);
    GPIO__DR_CLEAR = (1U << BUTTON_BIT);
    GPIO__DR_SET = (1U << dynamicBit);
    GPIO__DR_CLEAR = (1U << dynamicBit);
    GPIO__DR_SET = (1U << cnx_clamp_add_u32(LED_BIT, 1));
    GPIO__DR_CLEAR = (1U << cnx_clamp_mul_u32(LED_BIT, 2));
    uint32_t targetBit = LED_BIT;
    GPIO__DR_TOGGLE = (1U << targetBit);
    GPIO__DR = (GPIO__DR & ~(1U << LED_BIT)) | (1U << LED_BIT);
    GPIO__DR = (GPIO__DR & ~(1U << BUTTON_BIT)) | (0U << BUTTON_BIT);
    bool state = ((((GPIO__DR >> LED_BIT) & 1)) != 0U);
    if (state == true) {
        GPIO__DR_CLEAR = (1U << LED_BIT);
    } else {
        GPIO__DR_SET = (1U << LED_BIT);
    }
}
