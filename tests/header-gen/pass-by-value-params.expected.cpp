/**
 * Generated by C-Next Transpiler from: pass-by-value-params.test.cnx
 * A safer C for embedded systems
 */

#include "pass-by-value-params.test.hpp"

#include <stdint.h>
#include <stdbool.h>
#include <limits.h>

// ADR-044: Overflow helper functions
#include <limits.h>

/* ADR-044 / Issue #94: the second parameter is the WIDER type, not the value type.
   Narrowing it first would let an out-of-range operand truncate INTO range and defeat
   the check: cnx_clamp_add_u8(0, 256) must saturate to 255, but (uint8_t)256 is 0, so a
   uint8_t parameter would return 0 -- the opposite of saturation. */

static inline uint32_t cnx_clamp_add_u32(uint32_t a, uint64_t b) {
    if (b > (uint64_t)(UINT32_MAX - a)) return UINT32_MAX;
    return (uint32_t)(a + (uint32_t)b);
}

static inline uint32_t cnx_clamp_mul_u32(uint32_t a, uint64_t b) {
    if (b != 0 && a > UINT32_MAX / b) return UINT32_MAX;
    return (uint32_t)(a * (uint32_t)b);
}

// Tests: Header generation with pass-by-value parameters
// Floats, enums, and ISR types should use pass-by-value, not pointers
/* Scope: Api */

float Api__addFloats(float a, float b) {
    return a + b;
}

bool Api__isOk(Status status) {
    return status == Status__Ok;
}

void Api__updateValue(uint32_t& value) {
    value = cnx_clamp_add_u32(value, 1U);
}

uint32_t Api__readValue(uint32_t value) {
    return cnx_clamp_mul_u32(value, 2U);
}

int main(void) {
    float sum = Api__addFloats(1.5, 2.5);
    int32_t sumInt = ((sum) >= ((float)INT32_MAX) ? static_cast<int32_t>(INT32_MAX) : (sum) < ((float)INT32_MIN) ? static_cast<int32_t>(INT32_MIN) : static_cast<int32_t>((sum)));
    if (sumInt != 4) return 1U;
    bool okResult = Api__isOk(Status__Ok);
    if (okResult == false) return 2U;
    bool errResult = Api__isOk(Status__Error);
    if (errResult == true) return 3U;
    uint32_t val = 10U;
    Api__updateValue(val);
    if (val != 11) return 4U;
    uint32_t doubled = Api__readValue(5U);
    if (doubled != 10) return 5U;
    return 0U;
}
