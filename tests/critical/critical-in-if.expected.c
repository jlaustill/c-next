/**
 * Generated by C-Next Transpiler
 * A safer C for embedded systems
 */

#include <stdint.h>
#include <stdbool.h>

// ADR-050: Platform-portable IRQ wrappers for critical sections
#if defined(__arm__) || defined(__ARM_ARCH)
// ARM platforms (including ARM Arduino like Teensy 4.x, Due, Zero)
// Provide inline assembly PRIMASK access to avoid CMSIS header dependencies
__attribute__((always_inline)) static inline uint32_t __cnx_get_PRIMASK(void) {
    uint32_t result;
    __asm volatile ("MRS %0, primask" : "=r" (result));
    return result;
}
__attribute__((always_inline)) static inline void __cnx_set_PRIMASK(uint32_t mask) {
    __asm volatile ("MSR primask, %0" :: "r" (mask) : "memory");
}
#if defined(ARDUINO)
static inline void __cnx_disable_irq(void) { noInterrupts(); }
#else
__attribute__((always_inline)) static inline void __cnx_disable_irq(void) {
    __asm volatile ("cpsid i" ::: "memory");
}
#endif
#elif defined(__AVR__)
// AVR Arduino: use SREG for interrupt state
// Note: Uses PRIMASK naming for API consistency across platforms (AVR has no PRIMASK)
// Returns uint8_t which is implicitly widened to uint32_t at call sites - this is intentional
static inline uint8_t __cnx_get_PRIMASK(void) { return SREG; }
static inline void __cnx_set_PRIMASK(uint8_t mask) { SREG = mask; }
static inline void __cnx_disable_irq(void) { cli(); }
#else
// Fallback: assume CMSIS is available
static inline void __cnx_disable_irq(void) { __disable_irq(); }
static inline uint32_t __cnx_get_PRIMASK(void) { return __get_PRIMASK(); }
static inline void __cnx_set_PRIMASK(uint32_t mask) { __set_PRIMASK(mask); }
#endif

// ADR-044: Overflow helper functions
#include <limits.h>

static inline uint32_t cnx_clamp_add_u32(uint32_t a, uint64_t b) {
    if (b > (uint64_t)(UINT32_MAX - a)) return UINT32_MAX;
    uint32_t result;
    if (__builtin_add_overflow(a, (uint32_t)b, &result)) return UINT32_MAX;
    return result;
}

static inline uint32_t cnx_clamp_mul_u32(uint32_t a, uint64_t b) {
    if (b != 0 && a > UINT32_MAX / b) return UINT32_MAX;
    uint32_t result;
    if (__builtin_mul_overflow(a, (uint32_t)b, &result)) return UINT32_MAX;
    return result;
}

// test-c-only
// test-coverage: 33.2-critical-inside-if
// Coverage: Section 7.7, 33.2 - Critical section inside if statements
// Tests: critical sections inside if/else branches
uint32_t sharedValue = 0;

bool flag = false;

void criticalInIfBranch(void) {
    if (flag == true) {
        {
            uint32_t __primask = __cnx_get_PRIMASK();
            __cnx_disable_irq();
            sharedValue = cnx_clamp_add_u32(sharedValue, 10);
            __cnx_set_PRIMASK(__primask);
        }
    }
}

void criticalInElseBranch(void) {
    if (flag == true) {
        sharedValue = cnx_clamp_add_u32(sharedValue, 1);
    } else {
        {
            uint32_t __primask = __cnx_get_PRIMASK();
            __cnx_disable_irq();
            sharedValue = cnx_clamp_add_u32(sharedValue, 100);
            __cnx_set_PRIMASK(__primask);
        }
    }
}

void criticalInBothBranches(void) {
    if (sharedValue > 50) {
        {
            uint32_t __primask = __cnx_get_PRIMASK();
            __cnx_disable_irq();
            sharedValue = 0;
            __cnx_set_PRIMASK(__primask);
        }
    } else {
        {
            uint32_t __primask = __cnx_get_PRIMASK();
            __cnx_disable_irq();
            sharedValue = cnx_clamp_add_u32(sharedValue, 25);
            __cnx_set_PRIMASK(__primask);
        }
    }
}

void criticalInNestedIf(void) {
    bool condition = true;
    if (condition == true) {
        if (sharedValue < 100) {
            {
                uint32_t __primask = __cnx_get_PRIMASK();
                __cnx_disable_irq();
                sharedValue = cnx_clamp_mul_u32(sharedValue, 2);
                __cnx_set_PRIMASK(__primask);
            }
        }
    }
}

void criticalInIfElseChain(void) {
    uint32_t mode = 2;
    if (mode == 1) {
        {
            uint32_t __primask = __cnx_get_PRIMASK();
            __cnx_disable_irq();
            sharedValue = 1;
            __cnx_set_PRIMASK(__primask);
        }
    } else if (mode == 2) {
        {
            uint32_t __primask = __cnx_get_PRIMASK();
            __cnx_disable_irq();
            sharedValue = 2;
            __cnx_set_PRIMASK(__primask);
        }
    } else {
        {
            uint32_t __primask = __cnx_get_PRIMASK();
            __cnx_disable_irq();
            sharedValue = 0;
            __cnx_set_PRIMASK(__primask);
        }
    }
}

int main(void) {
    flag = false;
    criticalInIfBranch();
    criticalInElseBranch();
    criticalInBothBranches();
    criticalInNestedIf();
    criticalInIfElseChain();
}
