/**
 * generated by cnx from: field-bit-index-register.test.cnx
 * A safer C for embedded systems
 * Requires: C++11.
 * atomic read-modify-write requires CMSIS + ARMv7-M.
 */

#include "field-bit-index-register.test.hpp"


#include <stdint.h>
#include <stdbool.h>
#include <cmsis_gcc.h>

// test-adr: 034
// #2251: a bit of a register member's bitmap field is a bit of the member.
// A write-1 member takes a plain store of the bit at the field's offset
// (5 for Mode[1]); an `rw` member a read-modify-write; an `atomic` bitmap's
// field bit the member's __LDREXB loop.
volatile Pins ap = {};

void set(const uint8_t i) {
    GPIO__SET = (uint8_t)(1U << 5U);
    GPIO__SET = (uint8_t)((3U & 0x3U) << 4U);
    GPIO__DATA = (uint8_t)((GPIO__DATA & ~(1U << (4U + i))) | (1U << (4U + i)));
    {
        /* ADR-049 / Issue #1807: atomic read-modify-write as an LDREX/STREX retry loop. The value is evaluated once, before the loop, so a failed store-exclusive does not evaluate it again. */
        bool __operand = true;
        do {
            uint8_t __old = __LDREXB(&ap);
            uint8_t __new = (__old & ~(1U << 5U)) | ((__operand ? 1U : 0U) << 5U);
            if (__STREXB(__new, &ap) == 0) {
                break;
            }
        } while (1);
    }
}

int main(void) {
    set(1U);
    const bool b = ((((((GPIO__DATA >> 4) & 0x7) >> 2U) & 1)) != 0U);
    if (b == true) {
        return 1U;
    }
    return 0U;
}
